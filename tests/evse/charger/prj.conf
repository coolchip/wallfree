## CMakeLists.txt
```
# SPDX-License-Identifier: Apache-2.0
cmake_minimum_required(VERSION 3.20.0)
list(APPEND ZEPHYR_EXTRA_MODULES ${CMAKE_CURRENT_SOURCE_DIR}/../../..)
find_package(Zephyr REQUIRED HINTS $ENV{ZEPHYR_BASE})
project(evse_charger_test)
FILE(GLOB app_sources src/*.c)
# simulierter Flash und Sektor-3-Abbild aus den Speichertests
target_sources(app PRIVATE ${app_sources} ../../nvm/src/flash_sim.c)
target_include_directories(app PRIVATE ../../nvm/src)
```

## prj.conf
```kconfig
# SPDX-License-Identifier: Apache-2.0
CONFIG_ZTEST=y
CONFIG_WALLFREE_EVSE=y
CONFIG_COMPILER_WARNINGS_AS_ERRORS=y
CONFIG_WALLFREE_NVM=y
CONFIG_WALLFREE_API=y
```

## src/sim.c
```c
/* SPDX-License-Identifier: Apache-2.0 */
#include <string.h>
#include "sim.h"

void sim_init(struct sim *s, const struct evse_config *cfg)
{
	memset(s, 0, sizeof(*s));
	s->cfg = *cfg;
	s->now = 1000;
	s->car = EVSE_CP_A;
	s->diode = true;
	s->pp_mv = 9000; /* kein Kabel */
	s->rcm_healthy = true;
	s->test_pulse_at = EVSE_MS_NONE;
	s->ld_model = LD_MODEL_KUESTER;
	s->pulse_start = EVSE_MS_NONE;
	s->last_edge = EVSE_MS_NONE;
	s->supply_mv = 12000;
}

void sim_start(struct sim *s)
{
	evse_init(&s->e, &s->cfg, s->actuator_locked ? EVSE_LOCK_LOCKED : EVSE_LOCK_UNLOCKED,
		  s->now);
}

static int32_t level_mv(enum evse_cp_state st)
{
	switch (st) {
	case EVSE_CP_A:
		return 12000;
	case EVSE_CP_B:
		return 9000;
	case EVSE_CP_C:
		return 6000;
	case EVSE_CP_D:
		return 3000;
	default:
		return 0; /* E: Kurzschluss */
	}
}

static void model(struct sim *s, struct evse_inputs *in)
{
	const struct evse_outputs *o = &s->e.out;

	/* CP: Fahrzeugpegel am positiven Plateau, Diode haelt -12 V */
	in->cp_pos_mv = level_mv(s->car);
	in->cp_neg_mv = s->diode ? 12000 : in->cp_pos_mv;
	if (s->car == EVSE_CP_A) {
		in->cp_neg_mv = 12000;
	}
	in->pp_mv = s->pp_mv;
	for (int i = 0; i < EVSE_DIN_COUNT; i++) {
		in->din_mv[i] = s->din_mv[i];
	}
	in->supply_mv = s->supply_mv;
	in->meter_valid = s->meter_valid;
	for (int i = 0; i < 3; i++) {
		in->phase_ma[i] = s->phase_ma[i];
		in->phase_v[i] = 230;
	}

	/* Bender: SWITCH_2 330 ms, SWITCH_1 770 ms nach Testbeginn, Reclose 1,9 s */
	if (o->rcm_test && s->test_pulse_at == EVSE_MS_NONE) {
		s->test_pulse_at = s->now;
	}
	bool sw1 = false, sw2 = false;

	if (s->test_pulse_at != EVSE_MS_NONE && s->rcm_healthy) {
		evse_ms_t t = s->now - s->test_pulse_at;

		sw2 = t >= 330 && t < 1900;
		sw1 = t >= 770 && t < 1900;
		if (t >= 2500) {
			s->test_pulse_at = EVSE_MS_NONE;
		}
	} else if (s->test_pulse_at != EVSE_MS_NONE && s->now - s->test_pulse_at >= 2500) {
		s->test_pulse_at = EVSE_MS_NONE;
	}
	if (s->rcm_fault_current) {
		sw1 = sw2 = true;
	}
	in->rcm.sw1 = sw1;
	in->rcm.sw2 = sw2;
	in->rcm.err = false;

	/* Aktor: Fahrt 200 ms nach Impulsbeginn, Endlage danach */
	bool pulse = o->lock_pulse || o->unlock_pulse;

	if (pulse && !s->pulse_was) {
		s->pulse_start = s->now;
	}
	bool moving = pulse && !s->actuator_stuck && s->pulse_start != EVSE_MS_NONE &&
		      (s->now - s->pulse_start) < 200;

	if (pulse && !s->actuator_stuck && s->now - s->pulse_start >= 200) {
		s->actuator_locked = o->lock_pulse;
	}
	s->pulse_was = pulse;

	bool ld = false;

	if (s->ld_model == LD_MODEL_KUESTER) {
		ld = moving;
	} else if (s->ld_model == LD_MODEL_PERMANENT) {
		ld = s->actuator_locked && !s->ld_force_off;
	}
	in->din_mv[EVSE_DIN_LD] = ld ? 12000 : 0;

	/* Schuetz-Sense: 50 Hz hinter dem Schuetz */
	if (((o->contactor && !s->no_pull) || s->welded) && (s->now % 20) == 0) {
		s->last_edge = s->now;
	}
	in->last_sense_edge = s->last_edge;
	in->protect_tripped = s->protect_tripped;
	in->new_block = (s->now % 8) == 0;
}

void sim_run(struct sim *s, int ms)
{
	for (int i = 0; i < ms; i++) {
		struct evse_inputs in = {0};

		s->now++;
		model(s, &in);
		evse_step(&s->e, &in, s->now);
		if (s->e.out.contactor && !s->contactor_prev) {
			s->contactor_on_count++;
		}
		s->contactor_prev = s->e.out.contactor;
	}
}

int sim_until_state(struct sim *s, enum evse_state st, int max_ms)
{
	for (int t = 0; t < max_ms; t++) {
		if (s->e.state == st) {
			return t;
		}
		sim_run(s, 1);
	}
	return s->e.state == st ? max_ms : -1;
}

void sim_boot(struct sim *s)
{
	sim_start(s);
	(void)sim_until_state(s, EVSE_S1_IDLE, 10000);
}
```

## src/sim.h
```c
/* SPDX-License-Identifier: Apache-2.0 */
/*
 * Simulationsmodell fuer Szenariotests des Ladeautomaten: Fahrzeug am CP,
 * Kabel am PP, Bender-Sensor mit Trip-Test, Verriegelungsaktor mit
 * LD-Rueckmeldung, Schuetz mit Sense-Signal. Rein fuer Tests, keine
 * Aussage ueber reale Hardware.
 */
#ifndef SIM_H_
#define SIM_H_

#include <wallfree/evse/charger.h>

enum ld_model {
	LD_MODEL_NONE = 0,
	LD_MODEL_PERMANENT, /* Kontakt geschlossen, solange verriegelt */
	LD_MODEL_KUESTER,   /* 12 V nur waehrend der Fahrt (Fremdquelle) */
};

struct sim {
	struct evse e;
	struct evse_config cfg;
	evse_ms_t now;

	/* Fahrzeug */
	enum evse_cp_state car; /* A..D, E = Kurzschluss */
	bool diode;
	int32_t pp_mv;

	/* Eingaenge */
	int32_t din_mv[EVSE_DIN_COUNT];

	/* Bender */
	bool rcm_healthy;
	bool rcm_fault_current; /* echter Fehlerstrom */
	evse_ms_t test_pulse_at;

	/* Aktor */
	enum ld_model ld_model;
	bool actuator_locked;
	bool actuator_stuck;
	evse_ms_t pulse_start;
	bool pulse_was;
	bool ld_force_off;      /* LD-Kontakt faellt weg */

	/* Schuetz */
	bool welded;
	bool no_pull;           /* zieht nicht an: keine Rueckmeldung trotz Soll ein */
	bool protect_tripped;   /* Schutzmerker der Hardwareschicht (SOLL-PROT-14) */
	evse_ms_t last_edge;

	/* Versorgung, Messquelle */
	int32_t supply_mv;
	bool meter_valid;
	int32_t phase_ma[3];

	/* Beobachtung */
	int contactor_on_count;
	bool contactor_prev;
};

void sim_init(struct sim *s, const struct evse_config *cfg);
void sim_start(struct sim *s); /* evse_init */
void sim_run(struct sim *s, int ms);
/* laufen lassen, bis Zustand erreicht ist; @return benoetigte ms oder -1 */
int sim_until_state(struct sim *s, enum evse_state st, int max_ms);
/* bis nach Anlauf in S1 */
void sim_boot(struct sim *s);

#endif
```

## src/test_charger.c
```c
/* SPDX-License-Identifier: Apache-2.0 */
/* Szenariotests Ladeautomat (Abschnitte 5, 7, 8, 9, 11) */
#include <zephyr/ztest.h>
#include "sim.h"

#define DIP(n) ((evse_dip_t)(1u << ((n) - 1)))

static struct sim s;
static struct evse_config cfg;

static void before(void *f)
{
	ARG_UNUSED(f);
	evse_config_defaults(&cfg);
	cfg.dip = 0;
	cfg.contactor_monitor = EVSE_CTM_SENSE;
	sim_init(&s, &cfg);
}

static void reinit(void)
{
	sim_init(&s, &cfg);
}

/* Fahrzeug anstecken und bis PWM an */
static void plug_to_pwm(void)
{
	s.car = EVSE_CP_B;
	zassert_true(sim_until_state(&s, EVSE_S5_PWM_ON, 10000) >= 0, "Zustand %d", s.e.state);
}

ZTEST(evse_charger, test_startup_5s)
{
	/* SOLL-SM-01/02 */
	sim_start(&s);
	sim_run(&s, 4900);
	zassert_equal(s.e.state, EVSE_S0_INIT);
	zassert_equal(s.e.out.cp_duty, EVSE_DUTY_OFF);
	zassert_false(s.e.out.contactor);
	sim_run(&s, 200);
	zassert_equal(s.e.state, EVSE_S1_IDLE);
	zassert_equal(s.e.rcm.test, EVSE_RCM_TEST_PASSED);
	zassert_equal(s.e.errors, 0, "Fehler 0x%x", s.e.errors);
}

ZTEST(evse_charger, test_basic_charge_cycle)
{
	sim_boot(&s);
	s.car = EVSE_CP_B;
	sim_run(&s, 100);
	zassert_true(s.e.state == EVSE_S4_SELFTEST, "Zustand %d", s.e.state);
	zassert_equal(s.e.out.cp_duty, EVSE_DUTY_OFF, "kein PWM vor dem Selbsttest");
	zassert_true(sim_until_state(&s, EVSE_S5_PWM_ON, 4000) >= 0);
	sim_run(&s, 1);
	zassert_equal(s.e.out.cp_duty, 266, "16 A Drehschalter");
	zassert_false(s.e.out.contactor);

	s.car = EVSE_CP_C;
	zassert_true(sim_until_state(&s, EVSE_S6_CHARGING, 500) >= 0);
	zassert_true(s.e.out.contactor);
	/* Defaults: ER 15 aus, LR 29 aus (ohne D4 Wunsch "verriegeln" gesetzt), VR 16, CR 17 */
	zassert_false(s.e.out.dout[EVSE_DOUT_ER]);
	zassert_true(s.e.out.dout[EVSE_DOUT_VR]);
	zassert_true(s.e.out.dout[EVSE_DOUT_CR]);
	zassert_equal(s.e.out.led_mode[EVSE_LED_READY], EVSE_LEDM_ON);

	/* SOLL-SM-62: Fahrzeug beendet -> sofort aus, PWM bleibt */
	s.car = EVSE_CP_B;
	sim_run(&s, 40);
	zassert_false(s.e.out.contactor);
	zassert_equal(s.e.state, EVSE_S5_PWM_ON);
	zassert_equal(s.e.out.cp_duty, 266);
	zassert_equal(s.e.rcm.test, EVSE_RCM_TEST_PASSED, "kein neuer Selbsttest (E18)");

	zassert_equal(s.e.lock.state, EVSE_LOCK_LOCKED, "ohne D4 sofort verriegelt (SOLL-LOCK-01)");

	s.car = EVSE_CP_A;
	zassert_true(sim_until_state(&s, EVSE_S1_IDLE, 200) >= 0);
	zassert_equal(s.e.out.cp_duty, EVSE_DUTY_OFF);
	/* SOLL-LOCK-01/23: ohne D4 bei CP A sofort entriegelt (blieb vorher LOCKED) */
	sim_run(&s, 100);
	zassert_equal(s.e.lock.state, EVSE_LOCK_UNLOCKED);
	zassert_equal(s.e.out.led_mode[EVSE_LED_CONNECT], EVSE_LEDM_OFF, "SOLL-LED-03");
}

ZTEST(evse_charger, test_selftest_once_per_plug)
{
	/* E18: Ruecksprung ueber Stromsperre ohne neuen Selbsttest */
	sim_boot(&s);
	plug_to_pwm();
	s.e.rt.external_ma = 0;
	zassert_true(sim_until_state(&s, EVSE_S3_WAIT, 100) >= 0);
	s.e.rt.external_ma = 10000;
	sim_run(&s, 50);
	zassert_equal(s.e.state, EVSE_S5_PWM_ON);
	sim_run(&s, 1);
	zassert_equal(s.e.out.cp_duty, 166);
}

ZTEST(evse_charger, test_ordered_stop_5s)
{
	/* E7b, SOLL-SM-70/71: Stromsperre im Laden, Fahrzeug reagiert nicht */
	sim_boot(&s);
	plug_to_pwm();
	s.car = EVSE_CP_C;
	zassert_true(sim_until_state(&s, EVSE_S6_CHARGING, 500) >= 0);
	s.e.rt.external_ma = 0;
	sim_run(&s, 20);
	zassert_equal(s.e.state, EVSE_S7_STOPPING);
	zassert_equal(s.e.out.cp_duty, EVSE_DUTY_OFF);
	zassert_true(s.e.out.contactor);
	sim_run(&s, 4950);
	zassert_true(s.e.out.contactor);
	sim_run(&s, 100);
	zassert_false(s.e.out.contactor, "spaetestens nach 5 s aus");
	zassert_equal(s.e.state, EVSE_S3_WAIT);
}

ZTEST(evse_charger, test_ordered_stop_vehicle_reacts)
{
	sim_boot(&s);
	plug_to_pwm();
	s.car = EVSE_CP_C;
	sim_until_state(&s, EVSE_S6_CHARGING, 500);
	s.e.rt.pause_request = true;
	sim_run(&s, 1000);
	zassert_true(s.e.out.contactor);
	s.car = EVSE_CP_B;
	sim_run(&s, 40);
	zassert_false(s.e.out.contactor);
	zassert_equal(s.e.state, EVSE_S3_WAIT);
}

ZTEST(evse_charger, test_rcm_trip_immediate_and_latched)
{
	/* E1, SOLL-PROT-04/08/11 */
	sim_boot(&s);
	plug_to_pwm();
	s.car = EVSE_CP_C;
	sim_until_state(&s, EVSE_S6_CHARGING, 500);
	s.rcm_fault_current = true;
	sim_run(&s, 1);
	zassert_false(s.e.out.contactor, "im selben Zyklus aus");
	zassert_true(s.e.errors & EVSE_ERR_RCM_DC6);
	s.rcm_fault_current = false;
	sim_run(&s, 1000);
	zassert_equal(s.e.state, EVSE_S9_ERROR);
	zassert_true(s.e.errors & EVSE_ERR_RCM_ANY, "verriegelnd");
	zassert_equal(s.e.out.cp_duty, EVSE_DUTY_OFF);
	/* Abstecken -> Selbsttest -> Ruecksetzen */
	s.car = EVSE_CP_A;
	zassert_true(sim_until_state(&s, EVSE_S1_IDLE, 5000) >= 0);
	zassert_equal(s.e.errors, 0);
}

ZTEST(evse_charger, test_rcm_retest_interval)
{
	/* F13: fehlschlagender Test frueheste Wiederholung nach 30 s */
	sim_boot(&s);
	s.rcm_fault_current = true;
	sim_run(&s, 10);
	s.rcm_fault_current = false;
	s.rcm_healthy = false; /* Sensor reagiert nicht mehr auf den Test */
	sim_run(&s, 5000);
	zassert_equal(s.e.state, EVSE_S9_ERROR);
	evse_ms_t first = s.e.rcm_retest_last;

	zassert_true(first != EVSE_MS_NONE);
	sim_run(&s, 20000);
	zassert_equal(s.e.rcm_retest_last, first);
	s.rcm_healthy = true;
	sim_run(&s, 15000);
	zassert_equal(s.e.state, EVSE_S1_IDLE);
}

ZTEST(evse_charger, test_wakeup_once)
{
	/* E8/E17: nach 30 s B einmalig 3 s -12 V, 0,75 s +12 V */
	sim_boot(&s);
	plug_to_pwm();
	sim_run(&s, 29900);
	zassert_equal(s.e.out.cp_duty, 266);
	sim_run(&s, 200);
	zassert_equal(s.e.out.cp_duty, EVSE_DUTY_F);
	sim_run(&s, 2900);
	zassert_equal(s.e.out.cp_duty, EVSE_DUTY_F);
	sim_run(&s, 200);
	zassert_equal(s.e.out.cp_duty, EVSE_DUTY_OFF);
	sim_run(&s, 800);
	zassert_equal(s.e.out.cp_duty, 266);
	zassert_equal(s.e.state, EVSE_S5_PWM_ON);
	zassert_equal(s.e.errors, 0, "Weckfolge erzeugt keinen CP-Fehler");
	sim_run(&s, 40000);
	zassert_equal(s.e.out.cp_duty, 266, "nur einmal je Steckvorgang");
}

ZTEST(evse_charger, test_wakeup_wallbe_mode)
{
	cfg.wakeup_delay_ms = 5000;
	cfg.wakeup_mode = 1;
	reinit();
	sim_boot(&s);
	plug_to_pwm();
	sim_run(&s, 5100);
	zassert_equal(s.e.out.cp_duty, EVSE_DUTY_F);
	sim_run(&s, 4000);
	/* Stromsperre und Rueckkehr: Weckfolge erneut zulaessig */
	s.e.rt.external_ma = 0;
	sim_run(&s, 100);
	s.e.rt.external_ma = 16000;
	sim_run(&s, 5200);
	zassert_equal(s.e.out.cp_duty, EVSE_DUTY_F);
}

ZTEST(evse_charger, test_state_d)
{
	sim_boot(&s);
	plug_to_pwm();
	s.car = EVSE_CP_D;
	sim_run(&s, 100);
	zassert_equal(s.e.state, EVSE_S9_ERROR);
	zassert_true(s.e.errors & EVSE_ERR_STATE_D);
	zassert_equal(s.contactor_on_count, 0);
	s.car = EVSE_CP_A;
	sim_until_state(&s, EVSE_S1_IDLE, 200);
	zassert_equal(s.e.errors, 0);

	cfg.reject_state_d = false;
	reinit();
	sim_boot(&s);
	plug_to_pwm();
	s.car = EVSE_CP_D;
	zassert_true(sim_until_state(&s, EVSE_S6_CHARGING, 500) >= 0);
	zassert_true(evse_dout_eval(&s.e, 28, s.now), "Belueftung");
}

ZTEST(evse_charger, test_pwm5_never_closes)
{
	/* E6, SOLL-CUR-12, SOLL-SM-53 */
	cfg.rotary = 0;
	reinit();
	sim_boot(&s);
	plug_to_pwm();
	sim_run(&s, 1);
	zassert_equal(s.e.out.cp_duty, 50);
	s.car = EVSE_CP_C;
	sim_run(&s, 3000);
	zassert_equal(s.e.state, EVSE_S5_PWM_ON);
	zassert_false(s.e.out.contactor);
	zassert_true(s.e.digital_comm_unavailable);
	zassert_equal(s.contactor_on_count, 0);
}

ZTEST(evse_charger, test_rotary_invalid)
{
	/* E11 */
	cfg.rotary = 12;
	reinit();
	sim_start(&s);
	sim_run(&s, 6000);
	zassert_true(s.e.errors & EVSE_ERR_SWITCH);
	zassert_equal(s.e.state, EVSE_S9_ERROR);
	s.car = EVSE_CP_C;
	sim_run(&s, 5000);
	zassert_equal(s.e.out.cp_duty, EVSE_DUTY_OFF);
	zassert_equal(s.contactor_on_count, 0);
}

ZTEST(evse_charger, test_lock_kuester_pulsed)
{
	/* D4+D6, LD gepulst (Code 22 auf LD), Kuester-Modell */
	cfg.dip = DIP(4) | DIP(6);
	cfg.din.code[EVSE_DIN_LD] = EVSE_IN_LD_PULSED;
	reinit();
	s.ld_model = LD_MODEL_KUESTER;
	sim_boot(&s);
	zassert_equal(s.e.lock.state, EVSE_LOCK_UNLOCKED);
	s.car = EVSE_CP_B;
	zassert_true(sim_until_state(&s, EVSE_S3_WAIT, 6000) >= 0, "Zustand %d", s.e.state);
	zassert_true(s.actuator_locked);
	zassert_equal(s.e.lock.state, EVSE_LOCK_LOCKED);
	zassert_true(s.e.out.led_mode[EVSE_LED_CONNECT] == EVSE_LEDM_ON);
	zassert_true(sim_until_state(&s, EVSE_S5_PWM_ON, 4000) >= 0);
	s.car = EVSE_CP_C;
	zassert_true(sim_until_state(&s, EVSE_S6_CHARGING, 500) >= 0);
	s.car = EVSE_CP_B;
	sim_run(&s, 100);
	s.car = EVSE_CP_A;
	zassert_true(sim_until_state(&s, EVSE_S1_IDLE, 6000) >= 0);
	zassert_false(s.actuator_locked);
	zassert_equal(s.e.lock.state, EVSE_LOCK_UNLOCKED);
}

ZTEST(evse_charger, test_lock_permanent_fails_with_kuester)
{
	/* Code 3 an einem Kuester-Aktor: Verriegelung gilt nie als erfolgreich */
	cfg.dip = DIP(4) | DIP(6);
	reinit();
	s.ld_model = LD_MODEL_KUESTER;
	sim_boot(&s);
	s.car = EVSE_CP_B;
	zassert_true(sim_until_state(&s, EVSE_S9_ERROR, 60000) >= 0, "Zustand %d", s.e.state);
	zassert_true(s.e.errors & EVSE_ERR_LOCK);
	zassert_equal(s.e.lock_attempts, EVSE_LOCK_ATTEMPTS);
	zassert_equal(s.contactor_on_count, 0);
	s.car = EVSE_CP_A;
	sim_run(&s, 100);
	zassert_false(s.e.errors & EVSE_ERR_LOCK);
}

ZTEST(evse_charger, test_ld_lost_relock)
{
	/* SOLL-LOCK-40 (F9) mit permanentem Kontakt */
	cfg.dip = DIP(4) | DIP(6);
	reinit();
	s.ld_model = LD_MODEL_PERMANENT;
	sim_boot(&s);
	plug_to_pwm();
	s.car = EVSE_CP_C;
	zassert_true(sim_until_state(&s, EVSE_S6_CHARGING, 500) >= 0);
	s.ld_force_off = true;
	sim_run(&s, 140);
	zassert_false(s.e.out.contactor, "sofort aus");
	zassert_true(s.e.errors & EVSE_ERR_LD_LOST);
	zassert_equal(s.e.state, EVSE_S2_LOCKING);
	s.ld_force_off = false;
	zassert_true(sim_until_state(&s, EVSE_S6_CHARGING, 6000) >= 0, "Zustand %d", s.e.state);
	zassert_false(s.e.errors & EVSE_ERR_LD_LOST);
	zassert_equal(s.contactor_on_count, 2);
}

ZTEST(evse_charger, test_availability_xr)
{
	/* D8: XR fehlt -> F (-12 V); waehrend des Ladens geordnetes Ende */
	cfg.dip = DIP(8);
	reinit();
	s.din_mv[EVSE_DIN_XR] = 12000;
	sim_boot(&s);
	plug_to_pwm();
	s.car = EVSE_CP_C;
	sim_until_state(&s, EVSE_S6_CHARGING, 500);
	s.din_mv[EVSE_DIN_XR] = 0;
	sim_run(&s, 30);
	zassert_equal(s.e.state, EVSE_S7_STOPPING);
	s.car = EVSE_CP_B;
	sim_run(&s, 50);
	zassert_equal(s.e.state, EVSE_S10_UNAVAILABLE);
	zassert_equal(s.e.out.cp_duty, EVSE_DUTY_F);
	zassert_equal(s.e.status, EVSE_CP_F);
	s.din_mv[EVSE_DIN_XR] = 12000;
	sim_run(&s, 100);
	zassert_not_equal(s.e.state, EVSE_S10_UNAVAILABLE);
}

ZTEST(evse_charger, test_availability_lost_vehicle_ignores)
{
	/* Regression: S7 mit Ziel S10 muss die 5-s-Frist abarbeiten */
	cfg.dip = DIP(8);
	reinit();
	s.din_mv[EVSE_DIN_XR] = 12000;
	sim_boot(&s);
	plug_to_pwm();
	s.car = EVSE_CP_C;
	sim_until_state(&s, EVSE_S6_CHARGING, 500);
	s.din_mv[EVSE_DIN_XR] = 0;
	sim_run(&s, 4900);
	zassert_true(s.e.out.contactor);
	sim_run(&s, 200);
	zassert_false(s.e.out.contactor);
	zassert_equal(s.e.state, EVSE_S10_UNAVAILABLE);
}

ZTEST(evse_charger, test_diode_missing)
{
	/* SOLL-CP-07, F7 */
	sim_boot(&s);
	s.diode = false;
	plug_to_pwm();
	sim_run(&s, 200);
	zassert_equal(s.e.state, EVSE_S9_ERROR);
	zassert_true(s.e.errors & EVSE_ERR_DIODE);
	zassert_equal(s.e.out.cp_duty, EVSE_DUTY_F);
	sim_run(&s, 3000);
	zassert_equal(s.e.out.cp_duty, EVSE_DUTY_OFF, "nach 3 s +12 V");
	s.car = EVSE_CP_A;
	zassert_true(sim_until_state(&s, EVSE_S1_IDLE, 200) >= 0);
	zassert_false(s.e.errors & EVSE_ERR_DIODE);
}

ZTEST(evse_charger, test_contactor_welded)
{
	/* SOLL-PROT-21/23, F14 */
	sim_boot(&s);
	plug_to_pwm();
	s.car = EVSE_CP_C;
	sim_until_state(&s, EVSE_S6_CHARGING, 500);
	s.welded = true;
	s.car = EVSE_CP_B;
	sim_run(&s, 1000);
	zassert_true(s.e.errors & EVSE_ERR_CONTACTOR);
	zassert_equal(s.e.state, EVSE_S10_UNAVAILABLE);
	zassert_equal(s.e.out.cp_duty, EVSE_DUTY_F);
	s.welded = false;
	s.car = EVSE_CP_A;
	sim_run(&s, 1000);
	zassert_true(s.e.errors & EVSE_ERR_CONTACTOR, "kein automatisches Loeschen");
	zassert_true(evse_ack_contactor_fault(&s.e));
	sim_run(&s, 100);
	zassert_equal(s.e.state, EVSE_S1_IDLE);
}

ZTEST(evse_charger, test_permission_en)
{
	/* D7: Freigabe ueber EN (Schluesselschalter) */
	cfg.dip = DIP(7);
	reinit();
	sim_boot(&s);
	s.car = EVSE_CP_B;
	sim_run(&s, 5000);
	zassert_equal(s.e.state, EVSE_S3_WAIT);
	zassert_equal(s.e.out.cp_duty, EVSE_DUTY_OFF);
	s.din_mv[EVSE_DIN_EN] = 12000;
	zassert_true(sim_until_state(&s, EVSE_S5_PWM_ON, 4000) >= 0);
	s.car = EVSE_CP_C;
	sim_until_state(&s, EVSE_S6_CHARGING, 500);
	s.din_mv[EVSE_DIN_EN] = 0;
	sim_run(&s, 50);
	zassert_equal(s.e.state, EVSE_S7_STOPPING);
}

ZTEST(evse_charger, test_permission_d10_external)
{
	cfg.dip = DIP(10);
	reinit();
	sim_boot(&s);
	s.car = EVSE_CP_B;
	sim_run(&s, 3000);
	zassert_equal(s.e.state, EVSE_S3_WAIT, "external startet mit D10 bei 0 (F34)");
	s.e.rt.external_ma = 16000;
	zassert_true(sim_until_state(&s, EVSE_S5_PWM_ON, 4000) >= 0);
}

ZTEST(evse_charger, test_external_start_value_d10)
{
	/* SOLL-CUR-15, F34 */
	cfg.dip = DIP(10);
	reinit();
	sim_start(&s);
	zassert_equal(s.e.rt.external_ma, 0);
	cfg.dip = 0;
	reinit();
	sim_start(&s);
	zassert_equal(s.e.rt.external_ma, 80000);
}

ZTEST(evse_charger, test_external_releases_d10)
{
	/* SOLL-EN-01 b, SOLL-EN-12: evcc startet und beendet mit D10 allein ueber den Strom */
	cfg.dip = DIP(10);
	reinit();
	sim_boot(&s);
	s.car = EVSE_CP_B;
	sim_run(&s, 3000);
	zassert_equal(s.e.state, EVSE_S3_WAIT);
	zassert_false(s.e.permission);
	s.e.rt.external_ma = 10000;
	zassert_true(sim_until_state(&s, EVSE_S5_PWM_ON, 4000) >= 0);
	zassert_true(s.e.permission);
	zassert_equal(s.e.out.cp_duty, 166);
	s.car = EVSE_CP_C;
	zassert_true(sim_until_state(&s, EVSE_S6_CHARGING, 2000) >= 0);
	s.e.rt.external_ma = 0;
	sim_run(&s, 50);
	zassert_equal(s.e.state, EVSE_S7_STOPPING);
	zassert_false(s.e.permission);
}

ZTEST(evse_charger, test_key_forces_charging_d7_d10)
{
	/* SOLL-EN-13: Schluessel hebt die evcc-Vorgabe auf, auch bei 0 */
	cfg.dip = DIP(7) | DIP(10);
	reinit();
	sim_boot(&s);
	s.car = EVSE_CP_B;
	sim_run(&s, 3000);
	zassert_equal(s.e.state, EVSE_S3_WAIT, "ohne evcc und ohne Schluessel kein Laden");
	s.din_mv[EVSE_DIN_EN] = 12000;
	zassert_true(sim_until_state(&s, EVSE_S5_PWM_ON, 4000) >= 0);
	zassert_true(s.e.cur_in.external_ignored);
	zassert_equal(s.e.out.cp_duty, 266, "Drehschalter 16 A trotz external 0");
	s.e.rt.external_ma = 6000;
	sim_run(&s, 10);
	zassert_equal(s.e.out.cp_duty, 266, "evcc-Wert wirkungslos");
	s.car = EVSE_CP_C;
	zassert_true(sim_until_state(&s, EVSE_S6_CHARGING, 2000) >= 0);
	/* Schluessel aus: evcc-Wert gilt sofort wieder */
	s.din_mv[EVSE_DIN_EN] = 0;
	sim_run(&s, 50);
	zassert_false(s.e.cur_in.external_ignored);
	zassert_equal(s.e.state, EVSE_S6_CHARGING);
	zassert_equal(s.e.out.cp_duty, 100);
	/* evcc 0: geordnetes Ende */
	s.e.rt.external_ma = 0;
	sim_run(&s, 50);
	zassert_equal(s.e.state, EVSE_S7_STOPPING);
}

ZTEST(evse_charger, test_key_d7_only_keeps_external)
{
	/* SOLL-EN-13: mit D7 allein ist EN nur Erlaubnis */
	cfg.dip = DIP(7);
	reinit();
	sim_boot(&s);
	s.e.rt.external_ma = 6000;
	s.din_mv[EVSE_DIN_EN] = 12000;
	plug_to_pwm();
	zassert_false(s.e.cur_in.external_ignored);
	zassert_equal(s.e.out.cp_duty, 100);
}

ZTEST(evse_charger, test_unlock_request_during_charge)
{
	/* E7c, SOLL-LOCK-25 */
	cfg.dip = DIP(4) | DIP(6);
	cfg.din.code[EVSE_DIN_LD] = EVSE_IN_LD_PULSED;
	reinit();
	sim_boot(&s);
	plug_to_pwm();
	s.car = EVSE_CP_C;
	zassert_true(sim_until_state(&s, EVSE_S6_CHARGING, 500) >= 0);
	s.e.rt.unlock_request = true;
	sim_run(&s, 20);
	zassert_equal(s.e.state, EVSE_S7_STOPPING);
	s.car = EVSE_CP_B;
	zassert_true(sim_until_state(&s, EVSE_S8_UNLOCKING, 200) >= 0);
	zassert_false(s.e.out.contactor);
	sim_run(&s, 4000);
	zassert_false(s.actuator_locked);
	sim_run(&s, 10000);
	zassert_false(s.actuator_locked, "kein erneutes Verriegeln bis CP A");
	zassert_equal(s.contactor_on_count, 1);
}

ZTEST(evse_charger, test_cp_short)
{
	sim_boot(&s);
	plug_to_pwm();
	s.car = EVSE_CP_C;
	sim_until_state(&s, EVSE_S6_CHARGING, 500);
	s.car = EVSE_CP_E; /* 0 V */
	sim_run(&s, 40);
	zassert_false(s.e.out.contactor);
	zassert_true(s.e.errors & EVSE_ERR_CP_INVALID);
	zassert_equal(s.e.state, EVSE_S9_ERROR);
}

ZTEST(evse_charger, test_external_current_slot)
{
	sim_boot(&s);
	plug_to_pwm();
	s.e.rt.external_ma = 32000; /* F11: ueber Drehschalter -> 16 A */
	sim_run(&s, 10);
	zassert_equal(s.e.out.cp_duty, 266);
	s.e.rt.external_ma = 6000;
	sim_run(&s, 10);
	zassert_equal(s.e.out.cp_duty, 100);
	s.din_mv[EVSE_DIN_IN] = 12000; /* Code 11: 16 A, groesser als 6 A */
	sim_run(&s, 30);
	zassert_equal(s.e.out.cp_duty, 100);
}

/* F12: Werkswert ohne Einschraenkung; der Drehschalter (Default Stellung 4 = 16 A) begrenzt */
ZTEST(evse_charger, test_external_default_unlimited)
{
	evse_config_defaults(&cfg);
	cfg.dip = 0;
	zassert_equal(cfg.external_current_default_ma, EVSE_CURRENT_MAX_MA);
	reinit();
	sim_boot(&s);
	s.car = EVSE_CP_C;
	zassert_true(sim_until_state(&s, EVSE_S6_CHARGING, 10000) >= 0, "Zustand %d", s.e.state);
	zassert_equal(s.e.out.cp_duty, 266, "16 A Drehschalter");
	zassert_equal(s.e.cur_in.external_ma, EVSE_CURRENT_MAX_MA);
	zassert_equal(s.e.cur_in.hardware_ma, 16000);
}

ZTEST(evse_charger, test_safe_state)
{
	sim_boot(&s);
	plug_to_pwm();
	s.car = EVSE_CP_C;
	sim_until_state(&s, EVSE_S6_CHARGING, 500);
	evse_safe_state(&s.e, s.now);
	zassert_false(s.e.out.contactor);
	zassert_equal(s.e.out.cp_duty, EVSE_DUTY_F);
	sim_run(&s, 100);
	zassert_false(s.e.out.contactor, "bleibt sicher");
}

ZTEST_SUITE(evse_charger, NULL, NULL, before, NULL, NULL);
```

## src/test_charger2.c
```c
/* SPDX-License-Identifier: Apache-2.0 */
/* Weitere Szenarien: manuelle Verriegelung, Fehlerpfade, Eingangsfunktionen */
#include <zephyr/ztest.h>
#include <wallfree/api/evse_api.h>
#include "sim.h"

#define DIP(n) ((evse_dip_t)(1u << ((n) - 1)))

static struct sim s;
static struct evse_config cfg;

static void before(void *f)
{
	ARG_UNUSED(f);
	evse_config_defaults(&cfg);
	cfg.dip = 0;
	sim_init(&s, &cfg);
}

static void reinit(void)
{
	sim_init(&s, &cfg);
}

static void charge(void)
{
	s.car = EVSE_CP_B;
	zassert_true(sim_until_state(&s, EVSE_S5_PWM_ON, 15000) >= 0, "Zustand %d", s.e.state);
	s.car = EVSE_CP_C;
	zassert_true(sim_until_state(&s, EVSE_S6_CHARGING, 500) >= 0, "Zustand %d", s.e.state);
}

ZTEST(evse_charger2, test_manual_lock_d9)
{
	/* D9: Verriegelung folgt ML (Code 4), auch ohne Fahrzeug (SOLL-LOCK-24) */
	cfg.dip = DIP(4) | DIP(6) | DIP(9);
	cfg.din.code[EVSE_DIN_LD] = EVSE_IN_LD_PULSED;
	reinit();
	sim_boot(&s);
	s.car = EVSE_CP_B;
	sim_run(&s, 3000);
	zassert_equal(s.e.state, EVSE_S1_IDLE, "ohne ML kein Verriegeln, kein Pendeln");
	zassert_false(s.actuator_locked);
	s.din_mv[EVSE_DIN_ML] = 12000;
	charge();
	zassert_true(s.actuator_locked);
	/* ML aus waehrend des Ladens: geordnetes Ende, dann entriegeln (E7c) */
	s.din_mv[EVSE_DIN_ML] = 0;
	sim_run(&s, 30);
	zassert_equal(s.e.state, EVSE_S7_STOPPING);
	s.car = EVSE_CP_B;
	zassert_true(sim_until_state(&s, EVSE_S1_IDLE, 6000) >= 0, "Zustand %d", s.e.state);
	zassert_false(s.actuator_locked);
	/* Verriegeln ohne Fahrzeug */
	s.car = EVSE_CP_A;
	s.din_mv[EVSE_DIN_ML] = 12000;
	sim_run(&s, 4000);
	zassert_true(s.actuator_locked);
	zassert_equal(s.e.state, EVSE_S2_LOCKING);
}

ZTEST(evse_charger2, test_manual_lock_toggle)
{
	cfg.dip = DIP(4) | DIP(9);
	cfg.din.code[EVSE_DIN_ML] = EVSE_IN_ML_PULSED;
	reinit();
	sim_boot(&s);
	s.din_mv[EVSE_DIN_ML] = 12000;
	sim_run(&s, 100);
	s.din_mv[EVSE_DIN_ML] = 0;
	sim_run(&s, 3000);
	zassert_true(s.e.rt.lock_request);
	zassert_true(s.actuator_locked);
	s.din_mv[EVSE_DIN_ML] = 12000;
	sim_run(&s, 100);
	s.din_mv[EVSE_DIN_ML] = 0;
	sim_run(&s, 4000);
	zassert_false(s.e.rt.lock_request);
	zassert_false(s.actuator_locked);
}

ZTEST(evse_charger2, test_unlock_stuck)
{
	/* SOLL-LOCK-22: 4 Versuche, dann Fehler; kein Dauerversuch nach Abstecken */
	cfg.dip = DIP(4) | DIP(6);
	reinit();
	s.ld_model = LD_MODEL_PERMANENT;
	sim_boot(&s);
	charge();
	s.car = EVSE_CP_B;
	sim_run(&s, 50);
	s.actuator_stuck = true;
	s.car = EVSE_CP_A;
	zassert_true(sim_until_state(&s, EVSE_S9_ERROR, 30000) >= 0, "Zustand %d", s.e.state);
	zassert_true(s.e.errors & EVSE_ERR_UNLOCK);
	zassert_equal(s.e.unlock_attempts, EVSE_UNLOCK_ATTEMPTS);
	zassert_true(s.actuator_locked);
	zassert_equal(s.e.lock.state, EVSE_LOCK_LOCKED);
	/* danach keine weiteren Impulse */
	int pulses = 0;
	bool was = false;

	for (int i = 0; i < 20000; i++) {
		sim_run(&s, 1);
		bool p = s.e.out.unlock_pulse || s.e.out.lock_pulse;

		pulses += p && !was;
		was = p;
	}
	zassert_equal(pulses, 0, "%d Impulse", pulses);
	zassert_true(s.e.errors & EVSE_ERR_UNLOCK);
}

ZTEST(evse_charger2, test_relock_fails)
{
	/* SOLL-LOCK-40: Wiederverriegeln misslingt -> S9 bis CP A */
	cfg.dip = DIP(4) | DIP(6);
	reinit();
	s.ld_model = LD_MODEL_PERMANENT;
	sim_boot(&s);
	charge();
	s.ld_force_off = true;
	zassert_true(sim_until_state(&s, EVSE_S9_ERROR, 6000) >= 0, "Zustand %d", s.e.state);
	zassert_true(s.e.errors & EVSE_ERR_LD_LOST);
	zassert_false(s.e.out.contactor);
	zassert_equal(s.contactor_on_count, 1);
}

ZTEST(evse_charger2, test_init_unlock_failed)
{
	/* SOLL-LOCK-20: Start-Entriegelung misslingt */
	cfg.dip = DIP(4) | DIP(6);
	reinit();
	s.ld_model = LD_MODEL_PERMANENT;
	s.actuator_locked = true;
	s.actuator_stuck = true;
	sim_start(&s);
	sim_run(&s, 6000);
	zassert_equal(s.e.unlock_attempts, 1, "Startversuch zaehlt");
	/* weitere Versuche im Ablauf, insgesamt 4, dann Fehler */
	zassert_true(sim_until_state(&s, EVSE_S9_ERROR, 30000) >= 0, "Zustand %d", s.e.state);
	zassert_true(s.e.errors & EVSE_ERR_UNLOCK);
	zassert_equal(s.e.unlock_attempts, EVSE_UNLOCK_ATTEMPTS);
}

ZTEST(evse_charger2, test_overcurrent_with_meter)
{
	/* SOLL-PROT-31, E22: 1,25 x fuer 5 s */
	cfg.meter_available = true;
	cfg.overcurrent_enable = true;
	reinit();
	s.meter_valid = true;
	sim_boot(&s);
	charge();
	for (int i = 0; i < 3; i++) {
		s.phase_ma[i] = 20000; /* 1,25 x 15960 mA = 19950 */
	}
	sim_run(&s, 4900);
	zassert_true(s.e.out.contactor);
	sim_run(&s, 200);
	zassert_false(s.e.out.contactor);
	zassert_true(s.e.errors & EVSE_ERR_OVERCURRENT);
	zassert_equal(s.e.state, EVSE_S9_ERROR);
	s.car = EVSE_CP_A;
	sim_until_state(&s, EVSE_S1_IDLE, 200);
	zassert_false(s.e.errors & EVSE_ERR_OVERCURRENT);
}

ZTEST(evse_charger2, test_overcurrent_110_95s)
{
	cfg.meter_available = true;
	cfg.overcurrent_enable = true;
	reinit();
	s.meter_valid = true;
	sim_boot(&s);
	charge();
	for (int i = 0; i < 3; i++) {
		s.phase_ma[i] = 17600; /* > 1,1 x, < 1,25 x */
	}
	sim_run(&s, 94900);
	zassert_true(s.e.out.contactor);
	sim_run(&s, 200);
	zassert_false(s.e.out.contactor);
}

ZTEST(evse_charger2, test_meter_lost)
{
	cfg.meter_available = true;
	cfg.overcurrent_enable = true;
	reinit();
	s.meter_valid = true;
	sim_boot(&s);
	charge();
	s.meter_valid = false;
	sim_run(&s, 20);
	zassert_true(s.e.errors & EVSE_ERR_METER_COMM);
	zassert_equal(s.e.state, EVSE_S7_STOPPING, "geordnetes Ende");
}

ZTEST(evse_charger2, test_meter_mode_without_meter)
{
	cfg.contactor_monitor = EVSE_CTM_METER;
	reinit();
	sim_start(&s);
	zassert_true(s.e.errors & EVSE_ERR_CONFIG);
}

ZTEST(evse_charger2, test_supply_warning_only)
{
	/* F16 */
	sim_boot(&s);
	charge();
	s.supply_mv = 8000;
	sim_run(&s, 200);
	zassert_true(s.e.warnings & EVSE_WARN_SUPPLY);
	zassert_true(s.e.out.contactor, "keine Abschaltung");
	s.supply_mv = 9500;
	sim_run(&s, 3000);
	zassert_true(s.e.warnings & EVSE_WARN_SUPPLY, "Hysterese");
	s.supply_mv = 12000;
	sim_run(&s, 2600);
	zassert_false(s.e.warnings & EVSE_WARN_SUPPLY);
}

ZTEST(evse_charger2, test_cable_reject)
{
	/* D1+D2 (D3 aus): 20-A-Kabel abweisen */
	cfg.dip = DIP(1) | DIP(2);
	reinit();
	sim_boot(&s);
	s.pp_mv = 4000; /* 20 A */
	s.car = EVSE_CP_B;
	sim_run(&s, 3000);
	zassert_true(s.e.errors & EVSE_ERR_CABLE_REJECT);
	zassert_equal(s.e.state, EVSE_S9_ERROR);
	zassert_equal(s.contactor_on_count, 0);
	zassert_true(evse_dout_eval(&s.e, 26, s.now));
}

ZTEST(evse_charger2, test_cable_limit_and_pp_lost)
{
	/* D1: 13-A-Kabel begrenzt; PP faellt im Laden weg -> sofort aus */
	cfg.dip = DIP(1);
	reinit();
	sim_boot(&s);
	s.pp_mv = 6000; /* 13 A */
	sim_run(&s, 1100);
	charge();
	zassert_equal(s.e.out.cp_duty, 216);
	s.pp_mv = 9000; /* kein Kabel bei Fahrzeug */
	sim_run(&s, 1100);
	zassert_false(s.e.out.contactor);
	zassert_true(s.e.errors & EVSE_ERR_PP_INVALID);
}

ZTEST(evse_charger2, test_error_input)
{
	cfg.din.code[EVSE_DIN_IN] = EVSE_IN_ERROR;
	reinit();
	sim_boot(&s);
	charge();
	s.din_mv[EVSE_DIN_IN] = 12000;
	sim_run(&s, 30);
	zassert_false(s.e.out.contactor, "sofort (F8)");
	zassert_true(s.e.errors & EVSE_ERR_INPUT);
	s.din_mv[EVSE_DIN_IN] = 0;
	s.car = EVSE_CP_B;
	zassert_true(sim_until_state(&s, EVSE_S5_PWM_ON, 3000) >= 0, "Zustand %d", s.e.state);
}

ZTEST(evse_charger2, test_input_pwm5_pause_maxcurrent)
{
	cfg.din.code[EVSE_DIN_IN] = EVSE_IN_PWM5;
	cfg.din.code[EVSE_DIN_XR] = EVSE_IN_PAUSE;
	cfg.din.code[EVSE_DIN_ML] = EVSE_IN_MAX_CURRENT;
	reinit();
	sim_boot(&s);
	s.din_mv[EVSE_DIN_IN] = 12000;
	s.car = EVSE_CP_B;
	sim_until_state(&s, EVSE_S5_PWM_ON, 4000);
	sim_run(&s, 1);
	zassert_equal(s.e.out.cp_duty, 50);
	s.din_mv[EVSE_DIN_XR] = 12000; /* Pause hat Vorrang */
	sim_run(&s, 30);
	zassert_equal(s.e.state, EVSE_S3_WAIT);
	s.din_mv[EVSE_DIN_XR] = 0;
	s.din_mv[EVSE_DIN_IN] = 0;
	s.e.rt.external_ma = 0; /* evcc sperrt ... */
	sim_run(&s, 30);
	zassert_equal(s.e.state, EVSE_S3_WAIT);
	s.din_mv[EVSE_DIN_ML] = 12000; /* ... Code 19 ueberstimmt (F10) */
	sim_run(&s, 50);
	zassert_equal(s.e.state, EVSE_S5_PWM_ON);
	zassert_equal(s.e.out.cp_duty, 266);
	zassert_true(evse_dout_eval(&s.e, 38, s.now));
}

ZTEST(evse_charger2, test_pwm5_request_and_limit_override)
{
	sim_boot(&s);
	s.e.rt.hardware_limit_ma = 10000; /* SOLL-PAR-40 absenken */
	s.car = EVSE_CP_B;
	sim_until_state(&s, EVSE_S5_PWM_ON, 4000);
	sim_run(&s, 1);
	zassert_equal(s.e.out.cp_duty, 166);
	s.e.rt.hardware_limit_ma = 32000; /* hoeher als Drehschalter: wirkungslos */
	sim_run(&s, 10);
	zassert_equal(s.e.out.cp_duty, 266);
	s.e.rt.pwm5_request = true;
	sim_run(&s, 10);
	zassert_equal(s.e.out.cp_duty, 50);
}

ZTEST(evse_charger2, test_available_register_d10)
{
	cfg.dip = DIP(10);
	reinit();
	sim_boot(&s);
	s.e.rt.external_ma = 16000; /* F37: Freigabe mit D10 nur ueber external */
	s.e.rt.available_register = false;
	sim_run(&s, 50);
	zassert_equal(s.e.state, EVSE_S10_UNAVAILABLE);
	zassert_equal(s.e.out.cp_duty, EVSE_DUTY_F);
	s.e.rt.available_register = true;
	sim_run(&s, 50);
	zassert_equal(s.e.state, EVSE_S1_IDLE);
}

ZTEST(evse_charger2, test_wakeup_aborted_by_unplug)
{
	sim_boot(&s);
	s.car = EVSE_CP_B;
	sim_until_state(&s, EVSE_S5_PWM_ON, 4000);
	sim_run(&s, 31000);
	zassert_equal(s.e.out.cp_duty, EVSE_DUTY_F);
	/* waehrend -12 V kein Plateau: Abstecken wird in Phase 2 erkannt */
	s.car = EVSE_CP_A;
	zassert_true(sim_until_state(&s, EVSE_S1_IDLE, 4000) >= 0, "Zustand %d", s.e.state);
	zassert_equal(s.e.out.cp_duty, EVSE_DUTY_OFF);
}

ZTEST(evse_charger2, test_rcm_during_selftest_state_unplug)
{
	/* SOLL-SM-42: Abbruch des Selbsttests durch Abstecken */
	sim_boot(&s);
	s.car = EVSE_CP_B;
	zassert_true(sim_until_state(&s, EVSE_S4_SELFTEST, 1000) >= 0);
	sim_run(&s, 500);
	s.car = EVSE_CP_A;
	sim_run(&s, 100);
	zassert_equal(s.e.state, EVSE_S1_IDLE, "Zustand %d Fehler 0x%x raw %d", s.e.state, s.e.errors,
		      evse_cp_raw(&s.e.cp));
	zassert_equal(s.e.errors, 0);
	zassert_false(s.e.out.rcm_test);
}

ZTEST(evse_charger2, test_charge_time)
{
	sim_boot(&s);
	charge();
	sim_run(&s, 10000);
	s.car = EVSE_CP_B;
	sim_run(&s, 100);
	zassert_true(s.e.charge_ms >= 9900 && s.e.charge_ms <= 10200, "%lld",
		     (long long)s.e.charge_ms);
}

ZTEST(evse_charger2, test_protect_trip_while_charging)
{
	/* SOLL-PROT-14: Schutzmerker gesetzt, Automat kennt keinen Fehlerstrom -> ERR-RCM-TRIP
	 * statt S6 mit abgeschaltetem Schuetz (Testgeraet 2026-11-13) */
	sim_boot(&s);
	charge();
	s.protect_tripped = true;
	sim_run(&s, 10);
	zassert_true(s.e.errors & EVSE_ERR_RCM_TRIP, "Fehler 0x%x", s.e.errors);
	zassert_false(s.e.out.contactor);
	zassert_true(sim_until_state(&s, EVSE_S9_ERROR, 6000) >= 0, "Zustand %d", s.e.state);
	/* Merker loest die Hardwareschicht erst, wenn das Schuetz aus sein soll */
	s.protect_tripped = false;
	sim_run(&s, 1000);
	zassert_true(s.e.errors & EVSE_ERR_RCM_TRIP, "verriegelnd bis zum Selbsttest in A");
	/* Rücksetzung wie bei Fehlerstrom: Abstecken, Selbsttest in A (SOLL-PROT-08/11) */
	s.car = EVSE_CP_A;
	sim_run(&s, 40000);
	zassert_false(s.e.errors & EVSE_ERR_RCM_TRIP, "Fehler 0x%x", s.e.errors);
	zassert_equal(s.e.state, EVSE_S1_IDLE, "Zustand %d", s.e.state);
}

ZTEST(evse_charger2, test_protect_trip_contactor_off_no_error)
{
	/* SOLL-PROT-14: bei Schuetz aus (z. B. Testimpuls) kein Fehler */
	sim_boot(&s);
	s.protect_tripped = true;
	sim_run(&s, 100);
	zassert_equal(s.e.errors, 0, "Fehler 0x%x", s.e.errors);
	s.protect_tripped = false;
	charge();
	zassert_equal(s.e.errors, 0);
}

ZTEST(evse_charger2, test_contactor_no_pull)
{
	/* SOLL-PROT-25: Rueckmeldung fehlt nach dem Einschalten -> ERR-CONTACTOR nach 2 s */
	sim_boot(&s);
	s.no_pull = true;
	charge();
	sim_run(&s, 1900);
	zassert_false(s.e.errors & EVSE_ERR_CONTACTOR, "frühestens nach 2 s");
	sim_run(&s, 200);
	zassert_true(s.e.errors & EVSE_ERR_CONTACTOR, "Fehler 0x%x", s.e.errors);
	zassert_false(s.e.out.contactor);
	zassert_equal(s.e.state, EVSE_S10_UNAVAILABLE, "Zustand %d", s.e.state);
	zassert_equal(api_contactor_error(&s.e), 2, "WARP: sollte geschlossen sein");
}

ZTEST(evse_charger2, test_c1_reported_as_b)
{
	/* F36: Fahrzeug bleibt nach dem Ausschalten in C (Nissan Leaf, C1) -> WARP-Zustand B */
	sim_boot(&s);
	charge();
	zassert_equal(api_iec61851_state(&s.e), 2, "lädt: C");
	s.e.rt.external_ma = 0; /* evcc: Laden aus */
	sim_run(&s, 100);
	zassert_equal(evse_allowed_current(&s.e), 0);
	zassert_equal(evse_cp_raw(&s.e.cp), EVSE_CP_C, "Fahrzeug bleibt in C");
	zassert_equal(api_iec61851_state(&s.e), 1, "kein Strom erlaubt: B");
	sim_run(&s, 10000);
	zassert_false(s.e.out.contactor);
	zassert_equal(api_iec61851_state(&s.e), 1);
	/* wieder freigegeben: PWM an, Fahrzeug in C -> C */
	s.e.rt.external_ma = 16000;
	zassert_true(sim_until_state(&s, EVSE_S6_CHARGING, 10000) >= 0, "Zustand %d", s.e.state);
	zassert_equal(api_iec61851_state(&s.e), 2);
}

ZTEST(evse_charger2, test_contactor_pulls_no_error)
{
	sim_boot(&s);
	charge();
	sim_run(&s, 5000);
	zassert_equal(s.e.errors, 0, "Fehler 0x%x", s.e.errors);
	zassert_equal(s.e.state, EVSE_S6_CHARGING);
}

ZTEST_SUITE(evse_charger2, NULL, NULL, before, NULL, NULL);
```

## src/test_events.c
```c
/* SPDX-License-Identifier: Apache-2.0 */
/* Tests Ereignisse an die Schnittstellen (SOLL-ERR-10) */
#include <string.h>
#include <zephyr/ztest.h>
#include <wallfree/api/events.h>
#include <wallfree/api/reset.h>
#include "sim.h"

#define DIP(n) ((evse_dip_t)(1u << ((n) - 1)))

static struct evse_config cfg;
static struct sim s;
static struct wf_event log_ev[256];
static size_t n_log;

static void before(void *f)
{
	ARG_UNUSED(f);
	evse_config_defaults(&cfg);
	cfg.dip = 0;
	cfg.contactor_monitor = EVSE_CTM_SENSE;
	sim_init(&s, &cfg);
	n_log = 0;
}

ZTEST_SUITE(api_events, NULL, NULL, before, NULL, NULL);

/* wie der Automatenthread: Vergleich vor/nach jedem Schritt */
static void run(int ms)
{
	for (int i = 0; i < ms; i++) {
		struct wf_ev_snap a, b;
		struct wf_event ev[WF_EV_MAX_DIFF];

		wf_ev_snap_take(&s.e, &a);
		sim_run(&s, 1);
		wf_ev_snap_take(&s.e, &b);
		size_t n = wf_ev_diff(&a, &b, s.now, ev);

		for (size_t k = 0; k < n && n_log < ARRAY_SIZE(log_ev); k++) {
			log_ev[n_log++] = ev[k];
		}
	}
}

static int count(uint8_t type, int a)
{
	int c = 0;

	for (size_t i = 0; i < n_log; i++) {
		if (log_ev[i].type == type && (a < 0 || log_ev[i].a == a)) {
			c++;
		}
	}
	return c;
}

static int find_state(uint8_t to, size_t from)
{
	for (size_t i = from; i < n_log; i++) {
		if (log_ev[i].type == WF_EV_STATE && log_ev[i].b == to) {
			return (int)i;
		}
	}
	return -1;
}

ZTEST(api_events, test_diff)
{
	struct wf_ev_snap a = {.state = 1, .lock = EVSE_LOCK_UNLOCKED, .errors = 0x3};
	struct wf_ev_snap b = a;
	struct wf_event ev[WF_EV_MAX_DIFF];

	zassert_equal(wf_ev_diff(&a, &b, 5, ev), 0);
	b.errors = 0x6;
	b.contactor = true;
	b.lock = EVSE_LOCK_LOCKING; /* Zwischenschritt: kein Ereignis */
	b.state = 2;
	zassert_equal(wf_ev_diff(&a, &b, 5, ev), 3);
	zassert_equal(ev[0].type, WF_EV_ERROR);
	zassert_equal(ev[0].set, 0x4);
	zassert_equal(ev[0].cleared, 0x1);
	zassert_equal(ev[1].type, WF_EV_CONTACTOR);
	zassert_equal(ev[1].a, 1);
	zassert_equal(ev[2].type, WF_EV_STATE);
	zassert_equal(ev[2].a, 1);
	zassert_equal(ev[2].b, 2);
	zassert_equal(ev[2].t, 5);
	a = b;
	b.lock = EVSE_LOCK_LOCKED;
	zassert_equal(wf_ev_diff(&a, &b, 6, ev), 1);
	zassert_equal(ev[0].type, WF_EV_LOCK);
	zassert_equal(ev[0].a, EVSE_LOCK_LOCKED);
}

ZTEST(api_events, test_ring)
{
	struct wf_ev_ring r;
	struct wf_event ev;
	uint32_t seq = 1;

	wf_ev_ring_init(&r);
	zassert_false(wf_ev_ring_get(&r, &seq, &ev));
	for (int i = 0; i < 3; i++) {
		wf_ev_ring_push(&r, (struct wf_event){.t = i});
	}
	for (int i = 0; i < 3; i++) {
		zassert_true(wf_ev_ring_get(&r, &seq, &ev));
		zassert_equal(ev.seq, (uint32_t)i + 1);
		zassert_equal(ev.t, i);
	}
	zassert_false(wf_ev_ring_get(&r, &seq, &ev));
	zassert_equal(seq, 4);

	/* Ueberlauf: Leser bekommt das aelteste vorhandene, Luecke an seq sichtbar */
	for (int i = 3; i < 3 + WF_EV_RING + 5; i++) {
		wf_ev_ring_push(&r, (struct wf_event){.t = i});
	}
	zassert_true(wf_ev_ring_get(&r, &seq, &ev));
	zassert_equal(ev.seq, 3 + 5 + 1, "aeltestes vorhandenes");
	int n = 1;

	while (wf_ev_ring_get(&r, &seq, &ev)) {
		n++;
	}
	zassert_equal(n, WF_EV_RING);
	zassert_equal(ev.seq, 3 + WF_EV_RING + 5);
}

ZTEST(api_events, test_json)
{
	char buf[200];
	struct wf_jbuf b;
	const struct {
		struct wf_event ev;
		const char *json;
	} t[] = {
		{{.seq = 1, .t = 12, .type = WF_EV_STATE, .a = 1, .b = 5},
		 "{\"seq\":1,\"t_ms\":12,\"type\":\"state\",\"from\":1,\"to\":5}"},
		{{.seq = 2, .t = 13, .type = WF_EV_CONTACTOR, .a = 1},
		 "{\"seq\":2,\"t_ms\":13,\"type\":\"contactor\",\"on\":true}"},
		{{.seq = 3, .t = 14, .type = WF_EV_LOCK, .a = EVSE_LOCK_LOCKED},
		 "{\"seq\":3,\"t_ms\":14,\"type\":\"lock\",\"lock_state\":3}"},
		{{.seq = 4, .t = 15, .type = WF_EV_ERROR, .set = EVSE_ERR_RCM_DC6, .cleared = 0},
		 "{\"seq\":4,\"t_ms\":15,\"type\":\"error\",\"set\":[\"RCM-DC6\"],\"cleared\":[]}"},
		{{.seq = 5, .t = 16, .type = WF_EV_METER, .a = 3},
		 "{\"seq\":5,\"t_ms\":16,\"type\":\"meter\",\"status\":\"error\"}"},
		{{.seq = 6, .t = 17, .type = WF_EV_METER, .a = 2, .b = 1},
		 "{\"seq\":6,\"t_ms\":17,\"type\":\"meter\",\"status\":\"ok\","
		 "\"energy_decreased\":true}"},
		{{.seq = 7, .t = 18, .type = WF_EV_UPDATE, .a = 1, .b = 2},
		 "{\"seq\":7,\"t_ms\":18,\"type\":\"update\",\"ok\":true,\"mode\":2}"},
		{{.seq = 8, .t = 1, .type = WF_EV_BOOT, .a = WF_RST_USER},
		 "{\"seq\":8,\"t_ms\":1,\"type\":\"boot\",\"reason\":\"user_restart\"}"},
		{{.seq = 9, .t = 1, .type = WF_EV_BOOT, .a = WF_RST_LIMIT, .b = WF_RSTD_CHARGER},
		 "{\"seq\":9,\"t_ms\":1,\"type\":\"boot\",\"reason\":\"supervision_limit\","
		 "\"detail\":\"charger_thread\"}"},
		{{.seq = 10, .t = 1, .type = WF_EV_BOOT, .a = WF_RST_FAULT, .b = WF_RSTD_FAULT,
		  .set = 0x0801c235, .cleared = 3},
		 "{\"seq\":10,\"t_ms\":1,\"type\":\"boot\",\"reason\":\"fault\","
		 "\"detail\":\"fault\",\"pc\":\"0x0801c235\",\"fault\":3}"},
	};

	for (size_t i = 0; i < ARRAY_SIZE(t); i++) {
		wf_jb_init(&b, buf, sizeof(buf));
		wf_ev_json(&t[i].ev, &b);
		zassert_false(b.overflow);
		zassert_str_equal(buf, t[i].json);
	}
}

/* Steckvorgang mit Verriegelung: Zustaende, Verriegelung, Schuetz in richtiger Reihenfolge */
ZTEST(api_events, test_charging_cycle)
{
	cfg.dip = DIP(4);
	sim_init(&s, &cfg);
	sim_boot(&s);
	n_log = 0;
	s.car = EVSE_CP_B;
	run(8000);
	s.car = EVSE_CP_C;
	run(3000);
	zassert_equal(s.e.state, EVSE_S6_CHARGING, "Zustand %d", s.e.state);
	s.car = EVSE_CP_A;
	run(8000);
	zassert_equal(s.e.state, EVSE_S1_IDLE, "Zustand %d", s.e.state);

	int i_lock = find_state(EVSE_S2_LOCKING, 0);
	int i_chg = find_state(EVSE_S6_CHARGING, 0);
	int i_unl = find_state(EVSE_S8_UNLOCKING, 0);

	zassert_true(i_lock >= 0 && i_chg > i_lock && i_unl > i_chg);
	zassert_true(find_state(EVSE_S1_IDLE, i_unl) > i_unl);
	zassert_equal(count(WF_EV_CONTACTOR, 1), 1);
	zassert_equal(count(WF_EV_CONTACTOR, 0), 1);
	zassert_equal(count(WF_EV_LOCK, EVSE_LOCK_LOCKED), 1);
	zassert_equal(count(WF_EV_LOCK, EVSE_LOCK_UNLOCKED), 1);
	zassert_equal(count(WF_EV_ERROR, -1), 0);
	/* Schuetz ein erst im Laden, aus vor dem Entriegeln */
	for (size_t i = 0; i < n_log; i++) {
		if (log_ev[i].type == WF_EV_CONTACTOR) {
			zassert_true(log_ev[i].a ? (int)i >= i_chg - 1 : (int)i < i_unl);
		}
	}
}

/* Fehlerstrom beim Laden: Fehlerereignis, Schuetz aus, Zustand S9 */
ZTEST(api_events, test_rcm_fault)
{
	sim_boot(&s);
	s.car = EVSE_CP_C;
	run(8000);
	zassert_equal(s.e.state, EVSE_S6_CHARGING);
	n_log = 0;
	s.rcm_fault_current = true;
	run(200);
	zassert_true(n_log >= 3, "%u Ereignisse", (unsigned int)n_log);
	zassert_equal(log_ev[0].type, WF_EV_ERROR);
	zassert_true(log_ev[0].set & EVSE_ERR_RCM_ANY);
	zassert_equal(count(WF_EV_CONTACTOR, 0), 1);
	zassert_true(find_state(EVSE_S9_ERROR, 0) >= 0);
}
```

## src/test_outputs.c
```c
/* SPDX-License-Identifier: Apache-2.0 */
/* Wahrheitstabelle der Ausgangsfunktionen 0..42 (Tabelle 9.3) */
#include <zephyr/ztest.h>
#include <wallfree/evse/charger.h>

static struct evse e;

struct sit {
	enum evse_cp_state st;
	bool err;
	bool pwm;
};

static void setup(struct sit x)
{
	struct evse_config cfg;

	evse_config_defaults(&cfg);
	cfg.external_current_default_ma = EVSE_CURRENT_MAX_MA; /* Szenarien ohne Vorgabe der Schnittstelle */
	evse_init(&e, &cfg, EVSE_LOCK_UNLOCKED, 0);
	e.state = EVSE_S5_PWM_ON;
	e.status = x.st;
	e.errors = x.err ? EVSE_ERR_INPUT : 0;
	e.cp_duty = x.pwm ? 266 : EVSE_DUTY_OFF;
}

static bool ev(uint8_t code)
{
	return evse_dout_eval(&e, code, 100000);
}

/* Erwartung je Code fuer die Situationen A, B, B+PWM, C, D, E, F (ohne Fehler)
 * und A, B, C mit Fehler; Spaltenreihenfolge wie sits[] */
static const struct sit sits[] = {
	{EVSE_CP_A, false, false}, {EVSE_CP_B, false, false}, {EVSE_CP_B, false, true},
	{EVSE_CP_C, false, true},  {EVSE_CP_D, false, true},  {EVSE_CP_E, false, false},
	{EVSE_CP_F, false, false}, {EVSE_CP_A, true, false},  {EVSE_CP_B, true, true},
	{EVSE_CP_C, true, true},   {EVSE_CP_F, true, false},
};

#define N ARRAY_SIZE(sits)

static const struct {
	uint8_t code;
	const char *exp; /* je Situation '1' oder '0' */
} table[] = {
	/*          A B Bp C D E F Ae Be Ce Fe */
	{0, "00000000000"},
	{1, "10000000000"},
	{2, "01100000000"},
	{3, "00100000000"},
	{4, "01000000000"},
	{5, "00010000010"},
	{6, "00001000000"},
	{7, "00000101110"},
	{8, "00000010001"},
	{9, "11100000000"},
	{10, "10100000000"},
	{11, "11000000000"},
	{12, "11110000010"},
	{13, "11101000000"},
	{14, "11111000010"},
	{15, "00000111111"},
	{16, "00011000010"},
	{17, "00111000110"},
	{37, "01111000010"},
	{41, "11000000000"},
};

ZTEST(evse_outputs, test_state_codes)
{
	for (size_t t = 0; t < ARRAY_SIZE(table); t++) {
		for (size_t i = 0; i < N; i++) {
			setup(sits[i]);
			bool want = table[t].exp[i] == '1';

			zassert_equal(ev(table[t].code), want, "Code %u Situation %u",
				      table[t].code, (unsigned)i);
		}
	}
}

ZTEST(evse_outputs, test_cable_codes)
{
	static const int16_t cables[] = {0, 13, 20, 32, 63, -1};
	/* Codes 18..25 je Kabelwert */
	static const char *exp[] = {
		/* 0 13 20 32 63 -1 */
		"011110", /* 18 */
		"100001", /* 19 */
		"010000", /* 20 */
		"001000", /* 21 */
		"000100", /* 22 */
		"000010", /* 23 */
		"011000", /* 24 */
		"011100", /* 25 */
	};

	for (int c = 18; c <= 25; c++) {
		for (size_t i = 0; i < ARRAY_SIZE(cables); i++) {
			setup(sits[1]);
			e.pp.cable_a = cables[i];
			zassert_equal(ev(c), exp[c - 18][i] == '1', "Code %d Kabel %d", c,
				      cables[i]);
		}
	}
}

ZTEST(evse_outputs, test_flag_codes)
{
	setup(sits[3]);
	zassert_false(ev(26));
	e.errors = EVSE_ERR_CABLE_REJECT;
	zassert_true(ev(26));

	setup(sits[3]);
	zassert_false(ev(27));
	e.contactor = true;
	zassert_true(ev(27));

	setup(sits[4]);
	zassert_false(ev(28), "D ohne Laden");
	e.state = EVSE_S6_CHARGING;
	zassert_true(ev(28));

	setup(sits[0]);
	zassert_false(ev(29));
	e.last_lock_wish = true;
	zassert_true(ev(29));

	for (int i = 0; i < 4; i++) {
		setup(sits[0]);
		zassert_false(ev(30 + i));
		e.rt.register_output[i] = true;
		zassert_true(ev(30 + i));
	}

	setup(sits[3]);
	e.errors = EVSE_ERR_OVERCURRENT;
	zassert_true(ev(34));
	zassert_false(ev(35));
	e.errors = EVSE_ERR_CONTACTOR;
	zassert_true(ev(35));
	e.errors = EVSE_ERR_STATE_D;
	zassert_true(ev(36));
}

ZTEST(evse_outputs, test_special_codes)
{
	/* 38: Code-19-Eingang bei A/B, Nachlauf 1 s */
	setup(sits[0]);
	zassert_false(ev(38));
	e.din.max_current = true;
	zassert_true(ev(38));
	setup(sits[3]);
	e.din.max_current = true;
	e.contactor = false;
	e.contactor_off_since = 99500;
	zassert_true(ev(38), "Nachlauf");
	e.contactor_off_since = 98000;
	zassert_false(ev(38));

	/* 39: Freigabe und (C/D oder B nach Sperre) */
	setup(sits[3]);
	zassert_false(ev(39));
	e.release = true;
	zassert_true(ev(39));
	setup(sits[1]);
	e.release = true;
	zassert_false(ev(39));
	e.was_blocked = true;
	zassert_true(ev(39));

	/* 40: Blinken in S0, danach wie 9 */
	setup(sits[0]);
	e.state = EVSE_S0_INIT;
	zassert_true(evse_dout_eval(&e, 40, 100200));
	zassert_false(evse_dout_eval(&e, 40, 100700));
	e.state = EVSE_S1_IDLE;
	zassert_true(evse_dout_eval(&e, 40, 100700));

	/* 42: pausiert nach Laden */
	setup(sits[2]);
	zassert_false(ev(42));
	e.charged_this_plug = true;
	zassert_true(ev(42));

	/* unbekannt */
	setup(sits[0]);
	zassert_false(ev(43));
	zassert_false(ev(255));
}

ZTEST_SUITE(evse_outputs, NULL, NULL, NULL, NULL, NULL);
```
