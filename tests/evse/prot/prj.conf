## CMakeLists.txt
```
# SPDX-License-Identifier: Apache-2.0
cmake_minimum_required(VERSION 3.20.0)
list(APPEND ZEPHYR_EXTRA_MODULES ${CMAKE_CURRENT_SOURCE_DIR}/../../..)
find_package(Zephyr REQUIRED HINTS $ENV{ZEPHYR_BASE})
project(evse_prot_test)
FILE(GLOB app_sources src/*.c)
target_sources(app PRIVATE ${app_sources})
```

## prj.conf
```kconfig
# SPDX-License-Identifier: Apache-2.0
CONFIG_ZTEST=y
CONFIG_WALLFREE_EVSE=y
CONFIG_COMPILER_WARNINGS_AS_ERRORS=y
```

## src/test_lock.c
```c
/* SPDX-License-Identifier: Apache-2.0 */
/* Tests SOLL-LOCK-01..17 */
#include <zephyr/ztest.h>
#include <wallfree/evse/lock.h>

static struct evse_lock lk;
static struct evse_lock_config cfg;
static evse_ms_t now;
static bool ld_perm, ld_raw;
static int max_both_low; /* nie gleichzeitig aktiv */

/* 1-ms-Schritte; alle 8 ms ein neuer Messblock */
static void run(int ms)
{
	for (int i = 0; i < ms; i++) {
		now++;
		evse_lock_update(&lk, &cfg, ld_perm, ld_raw, (now % 8) == 0, now);
		if (lk.out_lock && lk.out_unlock) {
			max_both_low++;
		}
	}
}

/* bis Zyklusende laufen lassen, Dauer zurueckgeben */
static int run_cycle(void)
{
	int t = 0;

	while (evse_lock_busy(&lk) && t < 20000) {
		run(1);
		t++;
	}
	return t;
}

static void before(void *f)
{
	ARG_UNUSED(f);
	evse_lock_init(&lk, EVSE_LOCK_UNLOCKED);
	cfg = (struct evse_lock_config){
		.d4 = true, .d6 = false, .ld_mode = EVSE_LD_PERMANENT,
		.lock_pulse_ms = 500, .unlock_pulse_ms = 500, .cycle_gap_ms = 2000,
	};
	now = 1000;
	ld_perm = ld_raw = false;
	max_both_low = 0;
}

ZTEST(evse_lock, test_no_d4_immediate)
{
	cfg.d4 = false;
	zassert_true(evse_lock_request(&lk, &cfg, true, now));
	zassert_equal(lk.state, EVSE_LOCK_LOCKED);
	zassert_false(evse_lock_busy(&lk));
	zassert_equal(evse_lock_take_result(&lk), EVSE_LOCK_RES_OK);
	zassert_false(lk.out_lock);
}

ZTEST(evse_lock, test_pulse_without_d6)
{
	zassert_true(evse_lock_request(&lk, &cfg, true, now));
	zassert_equal(lk.state, EVSE_LOCK_LOCKING);
	zassert_false(evse_lock_request(&lk, &cfg, false, now), "busy");
	run(1);
	zassert_true(lk.out_lock, "erster Zyklus ohne Wartezeit");
	run(498);
	zassert_true(lk.out_lock);
	run(2);
	zassert_false(lk.out_lock);
	run_cycle();
	zassert_equal(lk.state, EVSE_LOCK_LOCKED);
	zassert_equal(evse_lock_take_result(&lk), EVSE_LOCK_RES_OK);
	zassert_equal(max_both_low, 0);
}

ZTEST(evse_lock, test_gap_between_cycles)
{
	/* SOLL-LOCK-10 */
	evse_lock_request(&lk, &cfg, true, now);
	run_cycle();
	evse_ms_t end = now;

	evse_lock_request(&lk, &cfg, false, now);
	while (!lk.out_unlock) {
		run(1);
	}
	zassert_true(now - end >= 2000, "Abstand %lld", (long long)(now - end));
	zassert_true(now - end <= 2001);
	run_cycle();
	zassert_equal(lk.state, EVSE_LOCK_UNLOCKED);
	zassert_equal(max_both_low, 0);
}

ZTEST(evse_lock, test_permanent_ld)
{
	/* SOLL-LOCK-13 */
	cfg.d6 = true;
	evse_lock_request(&lk, &cfg, true, now);
	run(300);
	ld_perm = true; /* Kontakt schliesst waehrend der Fahrt */
	int t = run_cycle();

	zassert_true(t >= 500 + 500 + 10 - 300, "Settle 500 ms nach Impuls");
	zassert_equal(lk.state, EVSE_LOCK_LOCKED);
	zassert_equal(evse_lock_take_result(&lk), EVSE_LOCK_RES_OK);

	/* Entriegeln, LD bleibt aktiv -> Misserfolg, bleibt LOCKED */
	evse_lock_request(&lk, &cfg, false, now);
	run_cycle();
	zassert_equal(lk.state, EVSE_LOCK_LOCKED);
	zassert_equal(evse_lock_take_result(&lk), EVSE_LOCK_RES_FAIL);
}

ZTEST(evse_lock, test_permanent_ld_missing)
{
	cfg.d6 = true;
	evse_lock_request(&lk, &cfg, true, now);
	run_cycle();
	zassert_equal(lk.state, EVSE_LOCK_UNLOCKED, "Misserfolg: Gegenteil des Ziels");
	zassert_equal(evse_lock_take_result(&lk), EVSE_LOCK_RES_FAIL);
}

static void pulse_ld_during(int start_ms, int len_ms)
{
	/* LD waehrend des Impulses kurz aktiv (Kuester: 12 V waehrend der Fahrt) */
	run(start_ms);
	ld_raw = true;
	run(len_ms);
	ld_raw = false;
}

ZTEST(evse_lock, test_pulsed_ld_ok)
{
	/* SOLL-LOCK-14 */
	cfg.d6 = true;
	cfg.ld_mode = EVSE_LD_PULSED;
	evse_lock_request(&lk, &cfg, true, now);
	pulse_ld_during(50, 200);
	run_cycle();
	zassert_equal(lk.state, EVSE_LOCK_LOCKED);
}

ZTEST(evse_lock, test_pulsed_ld_too_short)
{
	cfg.d6 = true;
	cfg.ld_mode = EVSE_LD_PULSED;
	evse_lock_request(&lk, &cfg, true, now);
	/* nur ein Block aktiv (Start auf Blockgrenze legen) */
	while ((now % 8) != 7) {
		run(1);
	}
	pulse_ld_during(0, 8);
	run_cycle();
	zassert_equal(lk.state, EVSE_LOCK_UNLOCKED);
}

ZTEST(evse_lock, test_pulsed_ld_stuck_high)
{
	/* Motor bleibt stehen: LD faellt nicht zurueck */
	cfg.d6 = true;
	cfg.ld_mode = EVSE_LD_PULSED;
	evse_lock_request(&lk, &cfg, true, now);
	run(50);
	ld_raw = true;
	run_cycle();
	zassert_equal(lk.state, EVSE_LOCK_UNLOCKED);
}

ZTEST(evse_lock, test_pulsed_unlock_check)
{
	/* F27: ohne Option kein LD noetig, mit Option Fahrt erforderlich */
	cfg.d6 = true;
	cfg.ld_mode = EVSE_LD_PULSED;
	evse_lock_init(&lk, EVSE_LOCK_LOCKED);
	evse_lock_request(&lk, &cfg, false, now);
	run_cycle();
	zassert_equal(lk.state, EVSE_LOCK_UNLOCKED);

	evse_lock_init(&lk, EVSE_LOCK_LOCKED);
	cfg.unlock_check = true;
	evse_lock_request(&lk, &cfg, false, now);
	run_cycle();
	zassert_equal(lk.state, EVSE_LOCK_LOCKED);

	evse_lock_init(&lk, EVSE_LOCK_LOCKED);
	evse_lock_request(&lk, &cfg, false, now);
	pulse_ld_during(40, 100);
	run_cycle();
	zassert_equal(lk.state, EVSE_LOCK_UNLOCKED);
}

ZTEST(evse_lock, test_d6_without_ld_fails)
{
	cfg.d6 = true;
	cfg.ld_mode = EVSE_LD_NONE;
	evse_lock_request(&lk, &cfg, true, now);
	ld_perm = true;
	run_cycle();
	zassert_equal(evse_lock_take_result(&lk), EVSE_LOCK_RES_FAIL);
}

ZTEST(evse_lock, test_abort)
{
	/* SOLL-LOCK-17 */
	evse_lock_request(&lk, &cfg, true, now);
	run(100);
	zassert_true(lk.out_lock);
	evse_lock_abort(&lk, now);
	zassert_false(lk.out_lock);
	zassert_false(evse_lock_busy(&lk));
	zassert_equal(lk.state, EVSE_LOCK_UNLOCKED);
	zassert_equal(evse_lock_take_result(&lk), EVSE_LOCK_RES_FAIL);
}

ZTEST(evse_lock, test_max_pulse)
{
	cfg.lock_pulse_ms = 3000;
	evse_lock_request(&lk, &cfg, true, now);
	run(1);
	evse_ms_t start = now;

	while (lk.out_lock) {
		run(1);
	}
	zassert_equal(now - start, 3000);
}

ZTEST_SUITE(evse_lock, NULL, NULL, before, NULL, NULL);
```

## src/test_rcm_ctm.c
```c
/* SPDX-License-Identifier: Apache-2.0 */
/* Tests SOLL-PROT-04..13 (RCM) und SOLL-PROT-20..23 (Schuetzueberwachung) */
#include <zephyr/ztest.h>
#include <wallfree/evse/rcm.h>
#include <wallfree/evse/ctm.h>

static struct evse_rcm rcm;
static struct evse_rcm_levels lv;
static evse_ms_t now;

/* Bender-Verhalten im Test nachbilden: SWITCH_2 ab t_sw2, SWITCH_1 ab t_sw1,
 * beide bis t_rel ausgeloest (Zeiten ab Teststart). */
struct sensor_model {
	int t_sw2, t_sw1, t_rel;
};

static void run_test(struct sensor_model m)
{
	evse_ms_t start = now;

	while (rcm.test == EVSE_RCM_TEST_RUNNING && now - start < 5000) {
		now += 5;
		int t = (int)(now - start);
		bool active = rcm.out_test || t >= 300; /* Testwicklung ab Impuls */

		lv.sw2 = active && m.t_sw2 >= 0 && t >= m.t_sw2 && t < m.t_rel;
		lv.sw1 = active && m.t_sw1 >= 0 && t >= m.t_sw1 && t < m.t_rel;
		evse_rcm_selftest_update(&rcm, &lv, now);
	}
}

static void before(void *f)
{
	ARG_UNUSED(f);
	evse_rcm_init(&rcm);
	lv = (struct evse_rcm_levels){0};
	now = 0;
}

ZTEST(evse_rcm, test_check_all_bits)
{
	struct evse_rcm_levels l = {.sw1 = true, .sw2 = true, .err = true};

	zassert_equal(evse_rcm_check(&l),
		      EVSE_RCM_F_SENSOR | EVSE_RCM_F_DC6 | EVSE_RCM_F_AC30);
}

ZTEST(evse_rcm, test_monitor_latches)
{
	/* SOLL-PROT-08: Auto-Reclose des Sensors loescht den Fehler nicht */
	lv.sw1 = true;
	zassert_true(evse_rcm_monitor(&rcm, &lv));
	lv.sw1 = false;
	zassert_false(evse_rcm_monitor(&rcm, &lv));
	zassert_equal(rcm.faults, EVSE_RCM_F_AC30);
}

ZTEST(evse_rcm, test_selftest_pass_bender_iec)
{
	/* Bender IEC: SWITCH_2 ~330 ms, SWITCH_1 ~770 ms nach Teststart des Sensors,
	 * Auto-Reclose ~500 ms nach Ende der Testwicklung (1,4 s) */
	rcm.faults = EVSE_RCM_F_DC6; /* alter Fehler wird durch Bestehen geloescht */
	zassert_true(evse_rcm_selftest_start(&rcm, &lv, now));
	run_test((struct sensor_model){.t_sw2 = 200 + 330, .t_sw1 = 200 + 770, .t_rel = 2300});
	zassert_equal(rcm.test, EVSE_RCM_TEST_PASSED);
	zassert_equal(rcm.faults, 0);
	zassert_false(rcm.out_test);
}

ZTEST(evse_rcm, test_selftest_pulse_timing)
{
	evse_rcm_selftest_start(&rcm, &lv, now);
	evse_ms_t start = now, on = -1, off = -1;

	while (rcm.test == EVSE_RCM_TEST_RUNNING && now - start < 400) {
		now += 1;
		evse_rcm_selftest_update(&rcm, &lv, now);
		if (rcm.out_test && on < 0) {
			on = now - start;
		}
		if (!rcm.out_test && on >= 0 && off < 0) {
			off = now - start;
		}
	}
	zassert_equal(on, 200);
	zassert_equal(off, 300);
}

ZTEST(evse_rcm, test_selftest_fail_points)
{
	/* M1: SWITCH_2 reagiert nicht */
	evse_rcm_selftest_start(&rcm, &lv, now);
	run_test((struct sensor_model){.t_sw2 = -1, .t_sw1 = 970, .t_rel = 2300});
	zassert_equal(rcm.test, EVSE_RCM_TEST_FAILED);
	zassert_equal(rcm.faults, EVSE_RCM_F_DC6 | EVSE_RCM_F_SELFTEST);

	/* M2: SWITCH_1 reagiert nicht */
	before(NULL);
	evse_rcm_selftest_start(&rcm, &lv, now);
	run_test((struct sensor_model){.t_sw2 = 530, .t_sw1 = -1, .t_rel = 2300});
	zassert_equal(rcm.faults, EVSE_RCM_F_AC30 | EVSE_RCM_F_SELFTEST);

	/* M3: beide bleiben ausgeloest */
	before(NULL);
	evse_rcm_selftest_start(&rcm, &lv, now);
	run_test((struct sensor_model){.t_sw2 = 530, .t_sw1 = 970, .t_rel = 99999});
	zassert_equal(rcm.faults, EVSE_RCM_F_SELFTEST);

	/* Rueckkehr zu spaet (einer bleibt bis nach 3,4 s) */
	before(NULL);
	evse_rcm_selftest_start(&rcm, &lv, now);
	evse_ms_t start = now;

	while (rcm.test == EVSE_RCM_TEST_RUNNING && now - start < 5000) {
		now += 5;
		int t = (int)(now - start);

		lv.sw2 = t >= 530 && t < 2000;
		lv.sw1 = t >= 970 && t < 3500;
		evse_rcm_selftest_update(&rcm, &lv, now);
	}
	zassert_equal(rcm.test, EVSE_RCM_TEST_FAILED);
	zassert_equal(rcm.faults, EVSE_RCM_F_SELFTEST);
}

ZTEST(evse_rcm, test_selftest_sensor_error)
{
	lv.err = true;
	zassert_false(evse_rcm_selftest_start(&rcm, &lv, now));
	zassert_true(rcm.faults & EVSE_RCM_F_SENSOR);

	before(NULL);
	evse_rcm_selftest_start(&rcm, &lv, now);
	now += 50;
	lv.err = true;
	evse_rcm_selftest_update(&rcm, &lv, now);
	zassert_equal(rcm.test, EVSE_RCM_TEST_FAILED);
	zassert_equal(rcm.faults, EVSE_RCM_F_SENSOR | EVSE_RCM_F_SELFTEST);
}

ZTEST(evse_rcm, test_selftest_abort)
{
	evse_rcm_selftest_start(&rcm, &lv, now);
	for (int i = 0; i < 50; i++) { /* 250 ms in 5-ms-Schritten */
		now += 5;
		evse_rcm_selftest_update(&rcm, &lv, now);
	}
	zassert_true(rcm.out_test);
	evse_rcm_selftest_abort(&rcm);
	zassert_false(rcm.out_test);
	zassert_equal(rcm.test, EVSE_RCM_TEST_ABORTING, "Sensor laeuft noch");
	/* erwartete Ausloesungen des Sensors sind kein Fehler */
	lv.sw2 = true;
	zassert_false(evse_rcm_monitor(&rcm, &lv));
	lv.err = true;
	zassert_true(evse_rcm_monitor(&rcm, &lv), "ERR_OUT bleibt wirksam");
	lv = (struct evse_rcm_levels){0};
	rcm.faults = 0;
	now += 3200;
	evse_rcm_selftest_update(&rcm, &lv, now);
	zassert_equal(rcm.test, EVSE_RCM_TEST_IDLE);
	zassert_equal(rcm.faults, 0);

	/* Abbruch vor dem Impuls: sofort beendet */
	before(NULL);
	evse_rcm_selftest_start(&rcm, &lv, now);
	now += 50;
	evse_rcm_selftest_update(&rcm, &lv, now);
	evse_rcm_selftest_abort(&rcm);
	zassert_equal(rcm.test, EVSE_RCM_TEST_IDLE);
}

ZTEST(evse_rcm, test_monitor_silent_during_test)
{
	evse_rcm_selftest_start(&rcm, &lv, now);
	lv.sw2 = true;
	zassert_false(evse_rcm_monitor(&rcm, &lv));
	zassert_equal(rcm.faults, 0);
}

ZTEST_SUITE(evse_rcm, NULL, NULL, before, NULL, NULL);

/* ---- Schuetzueberwachung ---- */

static struct evse_ctm ctm;
static struct evse_ctm_in cin;

static void ctm_before(void *f)
{
	ARG_UNUSED(f);
	evse_ctm_init(&ctm);
	cin = (struct evse_ctm_in){.contactor_on = false, .off_since = 0,
				   .last_sense_edge = EVSE_MS_NONE, .ct_nc = true};
	now = 0;
}

static void ctm_run(enum evse_ctm_mode mode, int ms, bool sense_pulses)
{
	for (int i = 0; i < ms; i++) {
		now++;
		if (sense_pulses && (now % 20) == 0) {
			cin.last_sense_edge = now; /* 50 Hz hinter dem Schuetz */
		}
		evse_ctm_update(&ctm, mode, &cin, now);
	}
}

ZTEST(evse_ctm, test_sense_welded)
{
	ctm_run(EVSE_CTM_SENSE, 200 + 249, true);
	zassert_false(ctm.fault);
	ctm_run(EVSE_CTM_SENSE, 30, true);
	zassert_true(ctm.fault);
	zassert_false(evse_ctm_acknowledge(&ctm), "noch erkannt");
	ctm_run(EVSE_CTM_SENSE, 200, false);
	zassert_true(ctm.fault, "F14: kein automatisches Loeschen");
	zassert_true(evse_ctm_acknowledge(&ctm));
	zassert_false(ctm.fault);
}

ZTEST(evse_ctm, test_sense_ok_and_delay)
{
	/* Spannung in den ersten 200 ms nach Aus ist erlaubt */
	ctm_run(EVSE_CTM_SENSE, 190, true);
	ctm_run(EVSE_CTM_SENSE, 1000, false);
	zassert_false(ctm.fault);
	/* bei eingeschaltetem Schuetz mit Rueckmeldung kein Fehler */
	cin.contactor_on = true;
	cin.on_since = now;
	ctm_run(EVSE_CTM_SENSE, 2000, true);
	zassert_false(ctm.fault);
}

ZTEST(evse_ctm, test_on_check)
{
	/* SOLL-PROT-25: ab 1000 ms nach Ein, Fehler nach weiteren 1000 ms ohne Rueckmeldung */
	cin.contactor_on = true;
	cin.on_since = now;
	ctm_run(EVSE_CTM_SENSE, 1999, false);
	zassert_false(ctm.fault);
	ctm_run(EVSE_CTM_SENSE, 2, false);
	zassert_true(ctm.fault);
	/* nach dem Aus ohne Rueckmeldung quittierbar */
	cin.contactor_on = false;
	cin.off_since = now;
	ctm_run(EVSE_CTM_SENSE, 300, false);
	zassert_true(evse_ctm_acknowledge(&ctm));

	/* Modus 2: Eingang Code 5 bleibt inaktiv */
	ctm_before(NULL);
	cin.contactor_on = true;
	cin.on_since = now;
	ctm_run(EVSE_CTM_NO, 2100, false);
	zassert_true(ctm.fault);
	/* Modus 3: Eingang Code 6 bleibt aktiv (ct_nc true) */
	ctm_before(NULL);
	cin.contactor_on = true;
	cin.on_since = now;
	ctm_run(EVSE_CTM_NC, 2100, false);
	zassert_true(ctm.fault);
	/* Modus 3 mit Rueckmeldung: Kontakt oeffnet */
	ctm_before(NULL);
	cin.contactor_on = true;
	cin.on_since = now;
	cin.ct_nc = false;
	ctm_run(EVSE_CTM_NC, 3000, false);
	zassert_false(ctm.fault);
	/* Modus 4 und 0: keine Pruefung im Ein */
	ctm_before(NULL);
	cin.contactor_on = true;
	cin.on_since = now;
	ctm_run(EVSE_CTM_METER, 3000, false);
	ctm_run(EVSE_CTM_OFF, 3000, false);
	zassert_false(ctm.fault);
}

/* Anzeige "Spannung an CT": unabhaengig von Modus und Schuetz-Soll */
ZTEST(evse_ctm, test_sense_display)
{
	cin.contactor_on = true;
	ctm_run(EVSE_CTM_OFF, 100, true);
	zassert_true(ctm.sense);
	ctm_run(EVSE_CTM_OFF, 99, false);
	zassert_true(ctm.sense, "letzte Flanke juenger als 100 ms");
	ctm_run(EVSE_CTM_OFF, 2, false);
	zassert_false(ctm.sense);
	zassert_false(ctm.fault);
}

ZTEST(evse_ctm, test_no_nc_modes)
{
	cin.ct_no = true;
	ctm_run(EVSE_CTM_NO, 500, false);
	zassert_true(ctm.fault);
	ctm_before(NULL);
	cin.ct_nc = false;
	ctm_run(EVSE_CTM_NC, 500, false);
	zassert_true(ctm.fault);
	ctm_before(NULL);
	cin.ct_no = true;
	ctm_run(EVSE_CTM_OFF, 500, false);
	zassert_false(ctm.fault);
}

ZTEST(evse_ctm, test_meter_any_phase)
{
	/* E4: jede Phase einzeln (Original nur alle drei gemeinsam) */
	cin.meter_valid = true;
	cin.phase_v[1] = 230;
	ctm_run(EVSE_CTM_METER, 500, false);
	zassert_true(ctm.fault);
	zassert_false(evse_ctm_mode_valid(EVSE_CTM_METER, false));
	zassert_true(evse_ctm_mode_valid(EVSE_CTM_METER, true));
	zassert_false(evse_ctm_mode_valid(5, true));
}

ZTEST_SUITE(evse_ctm, NULL, NULL, ctm_before, NULL, NULL);
```
