## CMakeLists.txt
```
# SPDX-License-Identifier: Apache-2.0
cmake_minimum_required(VERSION 3.20.0)
list(APPEND ZEPHYR_EXTRA_MODULES ${CMAKE_CURRENT_SOURCE_DIR}/../../..)
find_package(Zephyr REQUIRED HINTS $ENV{ZEPHYR_BASE})
project(evse_meas_test)
FILE(GLOB app_sources src/*.c)
target_sources(app PRIVATE ${app_sources})
```

## prj.conf
```kconfig
CONFIG_ZTEST=y
CONFIG_WALLFREE_EVSE=y
CONFIG_COMPILER_WARNINGS_AS_ERRORS=y
```

## src/test_cp.c
```c
/* SPDX-License-Identifier: Apache-2.0 */
/* Tests SOLL-CP-01..07 */
#include <zephyr/ztest.h>
#include <wallfree/evse/cp.h>

#define BLOCK_MS 8

static struct evse_cp cp;
static evse_ms_t now;

static struct evse_cp_sample dc_plus(int32_t pos)
{
	return (struct evse_cp_sample){.pos_mv = pos, .neg_mv = 0, .pos_valid = true};
}

/* Bloecke mit gleichem Messwert fuer eine Dauer einspeisen */
static void feed(struct evse_cp_sample s, int dur_ms)
{
	for (int t = 0; t < dur_ms; t += BLOCK_MS) {
		now += BLOCK_MS;
		evse_cp_update(&cp, &s, now);
	}
}

static void before(void *f)
{
	ARG_UNUSED(f);
	evse_cp_init(&cp);
	now = 0;
	cp.discard = 0;
}

ZTEST(evse_cp, test_band_limits)
{
	/* SOLL-CP-01: jeder Grenzwert und Nachbar */
	zassert_equal(evse_cp_band(14000, EVSE_CP_B), EVSE_CP_A);
	zassert_equal(evse_cp_band(11000, EVSE_CP_B), EVSE_CP_A);
	zassert_equal(evse_cp_band(10999, EVSE_CP_A), EVSE_CP_A);
	zassert_equal(evse_cp_band(10999, EVSE_CP_B), EVSE_CP_B);
	zassert_equal(evse_cp_band(10000, EVSE_CP_C), EVSE_CP_B);
	zassert_equal(evse_cp_band(9999, EVSE_CP_A), EVSE_CP_B);
	zassert_equal(evse_cp_band(8000, EVSE_CP_D), EVSE_CP_B);
	zassert_equal(evse_cp_band(7999, EVSE_CP_A), EVSE_CP_B);
	zassert_equal(evse_cp_band(7999, EVSE_CP_B), EVSE_CP_B);
	zassert_equal(evse_cp_band(7000, EVSE_CP_C), EVSE_CP_C);
	zassert_equal(evse_cp_band(6999, EVSE_CP_A), EVSE_CP_C);
	zassert_equal(evse_cp_band(5000, EVSE_CP_A), EVSE_CP_C);
	zassert_equal(evse_cp_band(4999, EVSE_CP_C), EVSE_CP_C);
	zassert_equal(evse_cp_band(4000, EVSE_CP_D), EVSE_CP_D);
	zassert_equal(evse_cp_band(3999, EVSE_CP_A), EVSE_CP_D);
	zassert_equal(evse_cp_band(2000, EVSE_CP_A), EVSE_CP_D);
	zassert_equal(evse_cp_band(1999, EVSE_CP_D), EVSE_CP_D);
	zassert_equal(evse_cp_band(1000, EVSE_CP_E), EVSE_CP_E);
	zassert_equal(evse_cp_band(999, EVSE_CP_A), -1);
}

ZTEST(evse_cp, test_debounce_20ms)
{
	/* SOLL-CP-03: Uebernahme erst nach > 20 ms Abweichung (3. Block nach Beginn) */
	struct evse_cp_sample b = dc_plus(9000);

	now += BLOCK_MS;
	evse_cp_update(&cp, &b, now); /* t=8, Beginn */
	zassert_equal(evse_cp_raw(&cp), EVSE_CP_A);
	now += BLOCK_MS;
	evse_cp_update(&cp, &b, now); /* 8 ms */
	now += BLOCK_MS;
	evse_cp_update(&cp, &b, now); /* 16 ms */
	zassert_equal(evse_cp_raw(&cp), EVSE_CP_A);
	now += BLOCK_MS;
	evse_cp_update(&cp, &b, now); /* 24 ms > 20 */
	zassert_equal(evse_cp_raw(&cp), EVSE_CP_B);
}

ZTEST(evse_cp, test_short_glitch_ignored)
{
	feed(dc_plus(9000), 16);
	feed(dc_plus(12000), 8);
	feed(dc_plus(9000), 16);
	zassert_equal(evse_cp_raw(&cp), EVSE_CP_A);
}

ZTEST(evse_cp, test_takes_current_candidate)
{
	/* B -> C waehrend der Frist: Abweichung durchgehend, uebernommen wird C */
	feed(dc_plus(9000), 16);
	feed(dc_plus(6000), 16);
	zassert_equal(evse_cp_raw(&cp), EVSE_CP_C);
}

ZTEST(evse_cp, test_invalid_short)
{
	/* SOLL-CP-06 */
	feed(dc_plus(9000), 40);
	zassert_equal(evse_cp_raw(&cp), EVSE_CP_B);
	feed(dc_plus(500), 16);
	zassert_false(cp.invalid);
	feed(dc_plus(500), 16);
	zassert_true(cp.invalid);
	/* Rohzustand bleibt erhalten (kein falsches "A") */
	zassert_equal(evse_cp_raw(&cp), EVSE_CP_B);
	/* 1,0..1,2 V: kein Fehler, Startzeit bleibt */
	feed(dc_plus(1100), 8);
	zassert_false(cp.invalid);
	feed(dc_plus(500), 8);
	zassert_true(cp.invalid, "Frist darf zwischen 1,0 und 1,2 V nicht neu beginnen");
	feed(dc_plus(1300), 8);
	feed(dc_plus(500), 8);
	zassert_false(cp.invalid, "ab 1,2 V beginnt die Frist neu");
}

ZTEST(evse_cp, test_no_pos_plateau)
{
	/* SOLL-CP-04: bei -12 V DC kein positives Plateau, kein "ungueltig" */
	struct evse_cp_sample s = {.pos_mv = 0, .neg_mv = 12000, .neg_valid = true};

	feed(dc_plus(9000), 40);
	feed(s, 200);
	zassert_false(cp.invalid);
	zassert_equal(evse_cp_raw(&cp), EVSE_CP_B);
}

ZTEST(evse_cp, test_discard_after_output_change)
{
	/* SOLL-CP-05 */
	feed(dc_plus(9000), 40);
	evse_cp_output_changed(&cp);
	now += BLOCK_MS;
	struct evse_cp_sample s = dc_plus(500);

	evse_cp_update(&cp, &s, now);
	evse_cp_update(&cp, &s, now + 1);
	zassert_equal(cp.discard, 0);
	zassert_equal(cp.invalid_since, EVSE_MS_NONE, "verworfene Bloecke duerfen nicht zaehlen");
}

ZTEST(evse_cp, test_diode)
{
	/* SOLL-CP-07 */
	struct evse_cp_sample s = {
		.pos_mv = 9000, .neg_mv = 5000, .pos_valid = true, .neg_valid = true,
		.pwm_active = true, .pwm_since = 0, .current_blocked = false,
	};

	now = 0;
	feed(s, 96); /* PWM < 100 ms + Frist: noch nicht */
	zassert_false(cp.diode_fault);
	feed(s, 24);
	zassert_false(cp.diode_fault);
	feed(s, 16);
	zassert_true(cp.diode_fault);
	/* verriegelnd */
	s.neg_mv = 12000;
	feed(s, 100);
	zassert_true(cp.diode_fault);
	evse_cp_clear_diode(&cp);
	zassert_false(cp.diode_fault);
}

ZTEST(evse_cp, test_diode_not_checked_when_blocked)
{
	struct evse_cp_sample s = {
		.pos_mv = 9000, .neg_mv = 5000, .pos_valid = true, .neg_valid = true,
		.pwm_active = true, .pwm_since = 0, .current_blocked = true,
	};

	feed(s, 400);
	zassert_false(cp.diode_fault);
	s.current_blocked = false;
	s.pwm_active = false;
	feed(s, 400);
	zassert_false(cp.diode_fault);
}

ZTEST(evse_cp, test_short_during_pwm_is_invalid)
{
	/* SOLL-CP-06/07: Kurzschluss bei PWM senkt beide Plateaus -> ungueltig, keine Diode */
	struct evse_cp_sample s = {
		.pos_mv = 6000, .neg_mv = 12000, .pos_valid = true, .neg_valid = true,
		.pwm_active = true, .pwm_since = 0, .current_blocked = false,
	};

	feed(s, 200);
	zassert_equal(evse_cp_raw(&cp), EVSE_CP_C);
	s.pos_mv = 300;
	s.neg_mv = 300;
	feed(s, 200);
	zassert_true(cp.invalid);
	zassert_false(cp.diode_fault, "Kurzschluss ist keine fehlende Diode");
	/* nach dem Loslassen wieder C, kein Fehler */
	s.pos_mv = 6000;
	s.neg_mv = 12000;
	feed(s, 100);
	zassert_false(cp.invalid);
	zassert_false(cp.diode_fault);
	/* fehlende Diode bei Zustand D wird weiter erkannt */
	s.pos_mv = 3000;
	s.neg_mv = 3000;
	feed(s, 100);
	zassert_true(cp.diode_fault);
}

ZTEST_SUITE(evse_cp, NULL, NULL, before, NULL, NULL);
```

## src/test_current.c
```c
/* SPDX-License-Identifier: Apache-2.0 */
/* Tests SOLL-CUR-01..22 und Drehschalter */
#include <zephyr/ztest.h>
#include <wallfree/evse/current.h>
#include <wallfree/evse/switches.h>

static struct evse_current_in in;
static struct evse_current_out out;

static void before(void *f)
{
	ARG_UNUSED(f);
	in = (struct evse_current_in){.hardware_ma = 16000, .external_ma = 80000};
}

ZTEST(evse_current, test_duty_examples)
{
	/* SOLL-CUR-20 Beispiele */
	zassert_equal(evse_duty_from_ma(6000), 100);
	zassert_equal(evse_duty_from_ma(16000), 266);
	zassert_equal(evse_duty_from_ma(32000), 533);
	zassert_equal(evse_duty_from_ma(51000), 850);
	zassert_equal(evse_duty_from_ma(51001), 850);
	zassert_equal(evse_duty_from_ma(52499), 850);
	zassert_equal(evse_duty_from_ma(52500), 850);
	zassert_equal(evse_duty_from_ma(52750), 851);
	zassert_equal(evse_duty_from_ma(80000), 960);
	zassert_equal(evse_duty_from_ma(5999), EVSE_DUTY_OFF);
}

ZTEST(evse_current, test_duty_never_exceeds)
{
	/* Kern von SOLL-CUR-20: Strom des Tastgrads <= Sollstrom, und maximal */
	for (int32_t ma = 6000; ma <= 80000; ma += 1) {
		uint16_t d = evse_duty_from_ma(ma);

		zassert_true(evse_ma_from_duty(d) <= ma, "ma=%d d=%u", ma, d);
		if (d < 960) {
			zassert_true(evse_ma_from_duty(d + 1) > ma, "nicht maximal: ma=%d", ma);
		}
	}
}

ZTEST(evse_current, test_ma_from_duty_ranges)
{
	/* HB S. 39 Tab. 6-3 */
	zassert_equal(evse_ma_from_duty(0), 0);
	zassert_equal(evse_ma_from_duty(50), 0, "5 %: digitale Kommunikation");
	zassert_equal(evse_ma_from_duty(79), 0);
	zassert_equal(evse_ma_from_duty(80), 6000);
	zassert_equal(evse_ma_from_duty(99), 6000);
	zassert_equal(evse_ma_from_duty(100), 6000);
	zassert_equal(evse_ma_from_duty(850), 51000);
	zassert_equal(evse_ma_from_duty(851), 52750);
	zassert_equal(evse_ma_from_duty(960), 80000);
	zassert_equal(evse_ma_from_duty(965), 80000);
	zassert_equal(evse_ma_from_duty(970), 80000);
	zassert_equal(evse_ma_from_duty(980), 85000);
	zassert_equal(evse_ma_from_duty(1000), 0, "100 %: keine PWM");
	zassert_equal(evse_duty_from_ma(100000), 960, "auf 80 A begrenzt");
	zassert_equal(evse_duty_from_ma(-5), EVSE_DUTY_OFF);
}

ZTEST(evse_current, test_implausible)
{
	/* SOLL-CUR-13: Slot ueber hardware kann nur durch Fehler entstehen */
	in.hardware_ma = 90000;
	in.external_ma = 90000;
	evse_current_eval(&in, &out);
	zassert_true(out.implausible);
	zassert_true(out.blocked);
	zassert_equal(out.duty, EVSE_DUTY_OFF);
	in.hardware_ma = 16000;
	in.external_ma = -1;
	evse_current_eval(&in, &out);
	zassert_equal(out.i_ma, 0);
	zassert_true(out.blocked);
}

ZTEST(evse_current, test_minimum_of_slots)
{
	evse_current_eval(&in, &out);
	zassert_equal(out.i_ma, 16000);
	in.cable_ma = 13000;
	evse_current_eval(&in, &out);
	zassert_equal(out.i_ma, 13000);
	in.input_ma = 10000;
	evse_current_eval(&in, &out);
	zassert_equal(out.i_ma, 10000);
	in.external_ma = 8000;
	evse_current_eval(&in, &out);
	zassert_equal(out.i_ma, 8000);
	zassert_equal(out.duty, 133);
	zassert_false(out.blocked);
	/* F10: Code 19 ignoriert external */
	in.external_ignored = true;
	evse_current_eval(&in, &out);
	zassert_equal(out.i_ma, 10000);
}

ZTEST(evse_current, test_above_limit_accepted)
{
	/* F11: 32000 bei 16-A-Drehschalter wird ueber das Minimum begrenzt */
	in.external_ma = 32000;
	evse_current_eval(&in, &out);
	zassert_equal(out.i_ma, 16000);
	zassert_false(out.implausible);
}

ZTEST(evse_current, test_block_below_6a)
{
	/* SOLL-CUR-11, E19 */
	in.external_ma = 5999;
	evse_current_eval(&in, &out);
	zassert_true(out.blocked);
	zassert_equal(out.duty, EVSE_DUTY_OFF);
	zassert_equal(out.allowed_ma, 0);
	in.external_ma = 0;
	evse_current_eval(&in, &out);
	zassert_true(out.blocked);
	in.external_ma = 6000;
	evse_current_eval(&in, &out);
	zassert_false(out.blocked);
	zassert_equal(out.duty, 100);
}

ZTEST(evse_current, test_pause)
{
	in.pause_input = true;
	evse_current_eval(&in, &out);
	zassert_true(out.blocked);
	in.pause_input = false;
	in.pause_request = true;
	evse_current_eval(&in, &out);
	zassert_true(out.blocked);
}

ZTEST(evse_current, test_pwm5)
{
	/* SOLL-CUR-12: alle drei Quellen, Pause hat Vorrang, Slots wirkungslos */
	in.external_ma = 0;
	in.hardware_pwm5 = true;
	evse_current_eval(&in, &out);
	zassert_true(out.pwm5_mode);
	zassert_equal(out.duty, 50);
	zassert_false(out.blocked);
	in.hardware_pwm5 = false;
	in.input_pwm5 = true;
	evse_current_eval(&in, &out);
	zassert_true(out.pwm5_mode);
	in.input_pwm5 = false;
	in.pwm5_request = true;
	evse_current_eval(&in, &out);
	zassert_true(out.pwm5_mode);
	in.pause_request = true;
	evse_current_eval(&in, &out);
	zassert_false(out.pwm5_mode);
	zassert_true(out.blocked);
}

ZTEST(evse_current, test_write_valid)
{
	zassert_true(evse_current_write_valid(0));
	zassert_false(evse_current_write_valid(1));
	zassert_false(evse_current_write_valid(5999));
	zassert_true(evse_current_write_valid(6000));
	zassert_true(evse_current_write_valid(80000));
	zassert_false(evse_current_write_valid(80001));
	zassert_false(evse_current_write_valid(-1));
}

ZTEST(evse_current, test_rotary)
{
	struct evse_rotary r = evse_rotary_decode(0);

	zassert_true(r.valid && r.pwm5);
	r = evse_rotary_decode(4);
	zassert_true(r.valid);
	zassert_equal(r.limit_ma, 16000);
	r = evse_rotary_decode(9);
	zassert_equal(r.limit_ma, 80000);
	for (uint8_t p = 10; p < 16; p++) {
		r = evse_rotary_decode(p);
		zassert_false(r.valid, "Position %u", p);
	}
}

ZTEST(evse_current, test_dip)
{
	evse_dip_t d = 0x201; /* D1 und D10 */

	zassert_true(evse_dip(d, 1));
	zassert_false(evse_dip(d, 2));
	zassert_true(evse_dip(d, 10));
	zassert_false(evse_dip(d, 11));
}

ZTEST_SUITE(evse_current, NULL, NULL, before, NULL, NULL);
```

## src/test_din.c
```c
/* SPDX-License-Identifier: Apache-2.0 */
/* Tests SOLL-IO-10..12, Abschnitt 9.1 */
#include <zephyr/ztest.h>
#include <wallfree/evse/din.h>

#define BLOCK_MS 8

static struct evse_din din;
static struct evse_din_config cfg;
static int32_t mv[EVSE_DIN_COUNT];
static evse_ms_t now;

static void step(int n)
{
	for (int i = 0; i < n; i++) {
		now += BLOCK_MS;
		evse_din_update(&din, &cfg, mv, now);
	}
}

static void before(void *f)
{
	ARG_UNUSED(f);
	evse_din_init(&din);
	/* Werkseinstellung E20: LD 3, EN 1, ML 4, XR 2, IN 11 */
	cfg = (struct evse_din_config){.code = {3, 1, 4, 2, 11}};
	for (int i = 0; i < EVSE_DIN_COUNT; i++) {
		mv[i] = 0;
	}
	now = 0;
}

ZTEST(evse_din, test_hysteresis_and_debounce)
{
	mv[EVSE_DIN_EN] = 12000;
	step(1);
	zassert_true(din.ch[EVSE_DIN_EN].hyst);
	zassert_false(din.en, "erst nach 2 Bloecken (F2)");
	step(1);
	zassert_true(din.en);
	/* Zwischenbereich haelt den Wert */
	mv[EVSE_DIN_EN] = 6000;
	step(5);
	zassert_true(din.en);
	mv[EVSE_DIN_EN] = 9000; /* nicht > 9000 */
	step(5);
	zassert_true(din.en);
	mv[EVSE_DIN_EN] = 2999;
	step(2);
	zassert_false(din.en);
}

ZTEST(evse_din, test_single_block_glitch)
{
	mv[EVSE_DIN_EN] = 12000;
	step(1);
	mv[EVSE_DIN_EN] = 0;
	step(1);
	zassert_false(din.en);
}

ZTEST(evse_din, test_limits_min_and_or)
{
	/* SOLL-CUR-03 kleinster aktiver Code; F26 ODER */
	cfg.code[EVSE_DIN_IN] = EVSE_IN_MAX_20A;
	cfg.code[EVSE_DIN_XR] = EVSE_IN_MAX_10A;
	mv[EVSE_DIN_IN] = 12000;
	step(2);
	zassert_equal(din.limit_ma, 20000);
	mv[EVSE_DIN_XR] = 12000;
	step(2);
	zassert_equal(din.limit_ma, 10000);

	cfg.code[EVSE_DIN_IN] = EVSE_IN_EN;
	mv[EVSE_DIN_EN] = 0;
	step(1);
	zassert_true(din.en, "EN auf zwei Klemmen: ODER");
}

ZTEST(evse_din, test_en_portal_like_en)
{
	cfg.code[EVSE_DIN_EN] = EVSE_IN_EN_PORTAL;
	mv[EVSE_DIN_EN] = 12000;
	step(2);
	zassert_true(din.en);
}

ZTEST(evse_din, test_en_pulsed_toggle_200ms)
{
	cfg.code[EVSE_DIN_EN] = EVSE_IN_EN_PULSED;
	mv[EVSE_DIN_EN] = 12000;
	step(2);
	zassert_true(din.en);
	mv[EVSE_DIN_EN] = 0;
	step(2);
	zassert_true(din.en, "Umschalten nur bei steigender Flanke");
	mv[EVSE_DIN_EN] = 12000;
	step(2); /* zweite Flanke nach 32 ms: gesperrt */
	zassert_true(din.en);
	mv[EVSE_DIN_EN] = 0;
	step(30);
	mv[EVSE_DIN_EN] = 12000;
	step(2);
	zassert_false(din.en);
}

ZTEST(evse_din, test_ml_events)
{
	mv[EVSE_DIN_ML] = 12000;
	step(1);
	zassert_equal(din.ml_event, EVSE_ML_EV_NONE);
	step(1);
	zassert_equal(din.ml_event, EVSE_ML_EV_SET1);
	step(1);
	zassert_equal(din.ml_event, EVSE_ML_EV_NONE);
	mv[EVSE_DIN_ML] = 0;
	step(2);
	zassert_equal(din.ml_event, EVSE_ML_EV_SET0);

	cfg.code[EVSE_DIN_ML] = EVSE_IN_ML_PULSED;
	mv[EVSE_DIN_ML] = 12000;
	step(2);
	zassert_equal(din.ml_event, EVSE_ML_EV_TOGGLE);
}

ZTEST(evse_din, test_ld_source)
{
	int ch;

	zassert_equal(evse_din_ld_source(&cfg, &ch), EVSE_LD_PERMANENT);
	zassert_equal(ch, EVSE_DIN_LD);
	cfg.code[EVSE_DIN_IN] = EVSE_IN_LD_PULSED;
	zassert_equal(evse_din_ld_source(&cfg, &ch), EVSE_LD_PULSED);
	zassert_equal(ch, EVSE_DIN_IN);
	cfg.code[EVSE_DIN_IN] = 0;
	cfg.code[EVSE_DIN_LD] = 0;
	zassert_equal(evse_din_ld_source(&cfg, &ch), EVSE_LD_NONE);
	zassert_equal(ch, -1);
}

ZTEST(evse_din, test_code_valid)
{
	zassert_true(evse_in_code_valid(0));
	zassert_true(evse_in_code_valid(22));
	zassert_false(evse_in_code_valid(23));
	zassert_false(evse_in_code_valid(-1));
}

ZTEST_SUITE(evse_din, NULL, NULL, before, NULL, NULL);
```

## src/test_pp.c
```c
/* SPDX-License-Identifier: Apache-2.0 */
/* Tests SOLL-PP-01..06 */
#include <zephyr/ztest.h>
#include <wallfree/evse/pp.h>

#define BLOCK_MS 8

static struct evse_pp pp;
static struct evse_pp_config cfg;
static evse_ms_t now;

static void feed(int32_t mv, enum evse_cp_state cp, int dur_ms)
{
	for (int t = 0; t < dur_ms; t += BLOCK_MS) {
		now += BLOCK_MS;
		evse_pp_update(&pp, &cfg, mv, cp, now);
	}
}

static void before(void *f)
{
	ARG_UNUSED(f);
	evse_pp_init(&pp);
	cfg = (struct evse_pp_config){.d1_proximity = true, .rotary_a = 16};
	now = 0;
}

ZTEST(evse_pp, test_classes)
{
	zassert_equal(evse_pp_classify(9000), 0);
	zassert_equal(evse_pp_classify(7401), 0);
	zassert_equal(evse_pp_classify(7400), 13);
	zassert_equal(evse_pp_classify(5331), 13);
	zassert_equal(evse_pp_classify(5330), 20);
	zassert_equal(evse_pp_classify(2821), 20);
	zassert_equal(evse_pp_classify(2820), 32);
	zassert_equal(evse_pp_classify(1521), 32);
	zassert_equal(evse_pp_classify(1520), 63);
	zassert_equal(evse_pp_classify(821), 63);
	zassert_equal(evse_pp_classify(820), EVSE_PP_INVALID);
}

ZTEST(evse_pp, test_hold_1s)
{
	/* SOLL-PP-03 */
	feed(2000, EVSE_CP_A, 1000);
	zassert_equal(pp.cable_a, 0);
	feed(2000, EVSE_CP_A, 16);
	zassert_equal(pp.cable_a, 32);
}

ZTEST(evse_pp, test_without_d1)
{
	/* SOLL-PP-01 */
	cfg.d1_proximity = false;
	feed(500, EVSE_CP_B, 16);
	zassert_equal(pp.cable_a, 16);
	zassert_false(pp.invalid);
	zassert_false(pp.reject);
}

ZTEST(evse_pp, test_invalid)
{
	/* SOLL-PP-04 */
	feed(500, EVSE_CP_A, 1100);
	zassert_true(pp.invalid);
	feed(9000, EVSE_CP_A, 1100);
	zassert_false(pp.invalid, "kein Kabel bei A ist kein Fehler");
	zassert_true(pp.unplugged_event || pp.cable_a == 0);
	feed(9000, EVSE_CP_B, 1100);
	zassert_true(pp.invalid, "kein Kabel bei erkanntem Fahrzeug");
	feed(9000, EVSE_CP_F, 1100);
	zassert_false(pp.invalid);
}

ZTEST(evse_pp, test_reject)
{
	/* SOLL-PP-05 */
	cfg.d2_reject = true;
	cfg.d3_only13 = true;
	feed(6000, EVSE_CP_B, 1100);
	zassert_equal(pp.cable_a, 13);
	zassert_true(pp.reject);
	feed(4000, EVSE_CP_B, 1100);
	zassert_equal(pp.cable_a, 20);
	zassert_false(pp.reject, "D3 an: nur 13 A abweisen");
	cfg.d3_only13 = false;
	feed(4000, EVSE_CP_B, 16);
	zassert_true(pp.reject, "D3 aus: auch 20 A abweisen");
	feed(2000, EVSE_CP_B, 1100);
	zassert_false(pp.reject);
	cfg.d2_reject = false;
	feed(6000, EVSE_CP_B, 1100);
	zassert_false(pp.reject);
}

ZTEST(evse_pp, test_unplug_event)
{
	/* SOLL-PP-06 */
	bool seen = false;

	feed(2000, EVSE_CP_A, 1100);
	for (int t = 0; t < 1100; t += BLOCK_MS) {
		now += BLOCK_MS;
		evse_pp_update(&pp, &cfg, 9000, EVSE_CP_A, now);
		seen |= pp.unplugged_event;
	}
	zassert_true(seen);
}

ZTEST_SUITE(evse_pp, NULL, NULL, before, NULL, NULL);
```
