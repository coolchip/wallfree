## CMakeLists.txt
```
# SPDX-License-Identifier: Apache-2.0
cmake_minimum_required(VERSION 3.20.0)
list(APPEND ZEPHYR_EXTRA_MODULES ${CMAKE_CURRENT_SOURCE_DIR}/../..)
find_package(Zephyr REQUIRED HINTS $ENV{ZEPHYR_BASE})
project(api_test)
FILE(GLOB app_sources src/*.c)
target_sources(app PRIVATE ${app_sources})
```

## prj.conf
```kconfig
# SPDX-License-Identifier: Apache-2.0
CONFIG_ZTEST=y
CONFIG_WALLFREE_EVSE=y
CONFIG_WALLFREE_API=y
CONFIG_COMPILER_WARNINGS_AS_ERRORS=y
```

## src/test_alog.c
```c
/* SPDX-License-Identifier: Apache-2.0 */
/* Tests Ereignisprotokoll (SOLL-ERR-11..13) */
#include <string.h>
#include <zephyr/ztest.h>
#include <wallfree/api/alog.h>

static struct wf_alog l;

static void before(void *f)
{
	ARG_UNUSED(f);
	wf_alog_init(&l);
}

ZTEST_SUITE(api_alog, NULL, NULL, before, NULL, NULL);

#define A 0xC0A80114 /* 192.168.1.20 */
#define B 0x0A000002

static struct wf_event state_ev(int64_t t, uint8_t from, uint8_t to)
{
	return (struct wf_event){.seq = 7, .t = t, .type = WF_EV_STATE, .a = from, .b = to};
}

ZTEST(api_alog, test_entries_in_order)
{
	struct wf_alog_entry e;
	uint32_t seq = 1;
	struct wf_event ev = state_ev(200, 1, 2);

	zassert_false(wf_alog_get(&l, &seq, &e));
	wf_alog_auth_fail(&l, A, 100);
	wf_alog_event(&l, &ev);
	wf_alog_auth_fail(&l, B, 300);

	zassert_true(wf_alog_get(&l, &seq, &e));
	zassert_equal(e.seq, 1);
	zassert_equal(e.kind, WF_ALOG_AUTH_FAIL);
	zassert_equal(e.addr, A);
	zassert_equal(e.count, 1);
	zassert_equal(e.t, 100);
	zassert_true(wf_alog_get(&l, &seq, &e));
	zassert_equal(e.kind, WF_ALOG_EVENT);
	zassert_equal(e.t, 200, "Zeit aus dem Ereignis");
	zassert_equal(e.ev.seq, 7, "Ereignisnummer bleibt erhalten");
	zassert_true(wf_alog_get(&l, &seq, &e));
	zassert_equal(e.seq, 3);
	zassert_equal(e.addr, B);
	zassert_false(wf_alog_get(&l, &seq, &e));
}

/* Durchprobieren von einer Adresse belegt nur einen Eintrag */
ZTEST(api_alog, test_repeated_failures_merge)
{
	struct wf_alog_entry e;
	uint32_t seq = 1;
	struct wf_event ev = state_ev(50, 1, 2);

	for (int i = 0; i < 100000; i++) {
		wf_alog_auth_fail(&l, A, 1000 + i);
	}
	zassert_true(wf_alog_get(&l, &seq, &e));
	zassert_equal(e.count, UINT16_MAX, "Zaehler bleibt stehen");
	zassert_equal(e.t, 1000 + 99999, "Zeit des letzten Versuchs");
	zassert_false(wf_alog_get(&l, &seq, &e));

	/* andere Adresse oder Ereignis dazwischen: neuer Eintrag */
	wf_alog_auth_fail(&l, B, 2);
	wf_alog_event(&l, &ev);
	wf_alog_auth_fail(&l, B, 3);
	zassert_equal(l.next_seq, 5);
}

ZTEST(api_alog, test_overflow_drops_oldest)
{
	struct wf_alog_entry e;
	uint32_t seq = 1;

	for (int i = 0; i < WF_ALOG_SIZE + 5; i++) {
		struct wf_event ev = state_ev(i, 1, 2);

		wf_alog_event(&l, &ev);
	}
	zassert_true(wf_alog_get(&l, &seq, &e));
	zassert_equal(e.seq, 6, "aeltestes vorhandenes, Luecke an seq");
	int n = 1;

	while (wf_alog_get(&l, &seq, &e)) {
		n++;
	}
	zassert_equal(n, WF_ALOG_SIZE);
	zassert_equal(e.seq, WF_ALOG_SIZE + 5);
}

ZTEST(api_alog, test_entry_json)
{
	char buf[300];
	struct wf_jbuf b;
	struct wf_alog_entry fail = {.seq = 4, .t = 5300, .kind = WF_ALOG_AUTH_FAIL, .count = 3,
				     .addr = A, .boot = 2};
	struct wf_alog_entry ev = {.seq = 5, .t = 6100, .kind = WF_ALOG_EVENT, .boot = 3,
				   .wall = 1793000000123,
				   .ev = {.seq = 9, .t = 6100, .type = WF_EV_CONTACTOR, .a = 1}};

	wf_jb_init(&b, buf, sizeof(buf));
	wf_alog_entry_json(&fail, &b);
	zassert_str_equal(buf, "{\"seq\":4,\"t_ms\":5300,\"boot\":2,\"kind\":\"auth_fail\","
			       "\"addr\":\"192.168.1.20\",\"count\":3}");
	wf_jb_init(&b, buf, sizeof(buf));
	wf_alog_entry_json(&ev, &b);
	zassert_str_equal(buf, "{\"seq\":5,\"t_ms\":6100,\"boot\":3,\"wall_ms\":1793000000123,"
			       "\"kind\":\"event\",\"event\":"
			       "{\"seq\":9,\"t_ms\":6100,\"type\":\"contactor\",\"on\":true}}");
}

/* Ausgabe in Teilen ergibt zusammengesetzt dasselbe wie in einem Stueck */
static size_t render(size_t chunk, char *all, size_t all_size)
{
	char buf[1024];
	struct wf_jbuf b;
	uint32_t cur = 0;
	size_t len = 0;
	int parts = 0;

	zassert_true(chunk <= sizeof(buf));
	do {
		wf_jb_init(&b, buf, chunk);
		cur = wf_alog_json(&l, cur, &b);
		zassert_false(b.overflow);
		zassert_true(b.len > 0, "jeder Teil bringt Fortschritt");
		zassert_true(len + b.len < all_size);
		memcpy(all + len, buf, b.len);
		len += b.len;
		zassert_true(++parts < 1000);
	} while (cur != WF_ALOG_DONE);
	all[len] = '\0';
	return len;
}

ZTEST(api_alog, test_json_empty)
{
	static char all[64];

	render(400, all, sizeof(all));
	zassert_str_equal(all, "{\"boot\":1,\"entries\":[]}");
}

ZTEST(api_alog, test_json_chunked)
{
	static char one[16384], parts[16384];

	for (int i = 0; i < WF_ALOG_SIZE + 3; i++) {
		struct wf_event ev = {.t = i, .type = WF_EV_ERROR, .set = EVSE_ERR_RCM_DC6 |
						     EVSE_ERR_CONTACTOR, .cleared = EVSE_ERR_LOCK};

		if (i % 3 == 0) {
			wf_alog_auth_fail(&l, A + (uint32_t)i, i);
		} else {
			wf_alog_event(&l, &ev);
		}
	}
	size_t n1 = render(1024, one, sizeof(one));
	size_t n2 = render(400, parts, sizeof(parts));

	zassert_equal(n1, n2);
	zassert_str_equal(one, parts);
	zassert_true(strncmp(parts, "{\"boot\":1,\"entries\":[{\"seq\":4,", 30) == 0, "aeltester zuerst");
	zassert_true(strcmp(parts + n2 - 3, "}]}") == 0);
	zassert_is_null(strstr(parts, ",,"));
	zassert_is_null(strstr(parts, "[,"));
}

/* SOLL-ERR-12: Inhalt uebersteht einen Neustart, Zufall nach Stromausfall nicht */
ZTEST(api_alog, test_restore)
{
	struct wf_alog_entry e;
	struct wf_event ev = {.type = WF_EV_STATE, .a = 0, .b = 1};
	uint32_t seq = 0;

	wf_alog_event(&l, &ev);
	wf_alog_auth_fail(&l, A, 200);
	zassert_equal(l.boot, 1);
	zassert_true(wf_alog_restore(&l), "stimmiger Inhalt bleibt");
	zassert_equal(l.boot, 2);
	wf_alog_auth_fail(&l, A, 50); /* neuer Start: nicht mit dem alten Eintrag zusammenfassen */
	zassert_true(wf_alog_get(&l, &seq, &e));
	zassert_equal(e.boot, 1);
	zassert_true(wf_alog_get(&l, &seq, &e));
	zassert_equal(e.count, 1);
	zassert_true(wf_alog_get(&l, &seq, &e));
	zassert_equal(e.boot, 2);
	zassert_equal(e.seq, 3, "Nummern laufen ueber den Neustart weiter");

	/* Uhrzeit: neue Eintraege tragen sie, die dieses Starts werden nachgetragen, die eines
	 * frueheren Starts nicht (dessen Startzeitpunkt ist unbekannt) */
	zassert_equal(e.wall, 0);
	wf_alog_set_wall_base(&l, 1793000000000);
	wf_alog_event(&l, &(struct wf_event){.t = 700, .type = WF_EV_CONTACTOR});
	zassert_true(wf_alog_get(&l, &seq, &e));
	zassert_equal(e.wall, 1793000000700);
	seq = 0;
	zassert_true(wf_alog_get(&l, &seq, &e));
	zassert_equal(e.boot, 1);
	zassert_equal(e.wall, 0, "frueherer Start bleibt ohne Uhrzeit");
	(void)wf_alog_get(&l, &seq, &e);
	zassert_true(wf_alog_get(&l, &seq, &e));
	zassert_equal(e.boot, 2);
	zassert_equal(e.wall, 1793000000050, "vor dem Abgleich: nachgetragen");
	zassert_true(wf_alog_restore(&l));
	zassert_equal(l.wall_base, 0, "nach Neustart wieder unbekannt");

	/* Stromausfall: Zufall bzw. beschaedigte Nummern -> neu */
	memset(&l, 0x5a, sizeof(l));
	zassert_false(wf_alog_restore(&l));
	zassert_equal(l.boot, 1);
	zassert_equal(l.next_seq, 1);
	wf_alog_event(&l, &ev);
	l.e[1].seq = 7;
	zassert_false(wf_alog_restore(&l));
	wf_alog_event(&l, &ev);
	l.version++;
	zassert_false(wf_alog_restore(&l));
}

/* SOLL-ERR-13: Loeschen hinterlaesst einen Eintrag mit Absender, Nummern laufen weiter */
ZTEST(api_alog, test_clear)
{
	struct wf_alog_entry e;
	struct wf_event ev = state_ev(100, 1, 2);
	uint32_t seq = 0;
	char buf[256];
	struct wf_jbuf b;

	wf_alog_auth_fail(&l, A, 50);
	wf_alog_event(&l, &ev);
	wf_alog_clear(&l, B, 900);
	zassert_true(wf_alog_get(&l, &seq, &e));
	zassert_equal(e.seq, 3, "Nummern laufen weiter");
	zassert_equal(e.kind, WF_ALOG_CLEARED);
	zassert_equal(e.addr, B);
	zassert_false(wf_alog_get(&l, &seq, &e), "aeltere Eintraege verworfen");

	wf_alog_auth_fail(&l, B, 950); /* nicht mit dem Loescheintrag zusammenfassen */
	zassert_true(wf_alog_get(&l, &seq, &e));
	zassert_equal(e.kind, WF_ALOG_AUTH_FAIL);
	zassert_equal(e.count, 1);

	wf_jb_init(&b, buf, sizeof(buf));
	zassert_equal(wf_alog_json(&l, 0, &b), WF_ALOG_DONE);
	zassert_str_equal(buf, "{\"boot\":1,\"entries\":["
			       "{\"seq\":3,\"t_ms\":900,\"boot\":1,\"kind\":\"cleared\",\"addr\":\"10.0.0.2\"},"
			       "{\"seq\":4,\"t_ms\":950,\"boot\":1,\"kind\":\"auth_fail\",\"addr\":\"10.0.0.2\","
			       "\"count\":1}]}");

	zassert_true(wf_alog_restore(&l), "geloeschter Stand uebersteht den Neustart");
	seq = 0;
	zassert_true(wf_alog_get(&l, &seq, &e));
	zassert_equal(e.seq, 3);

	/* nach dem Loeschen voller Umlauf: wie ohne Loeschen */
	for (int i = 0; i < WF_ALOG_SIZE + 5; i++) {
		wf_alog_event(&l, &ev);
	}
	seq = 0;
	zassert_true(wf_alog_get(&l, &seq, &e));
	zassert_equal(e.seq, l.next_seq - WF_ALOG_SIZE);
}
```

## src/test_api.c
```c
/* SPDX-License-Identifier: Apache-2.0 */
/* Tests MD5, Digest (SOLL-API-07) und JSON */
#include <stdio.h>
#include <string.h>
#include <zephyr/ztest.h>
#include <wallfree/api/digest.h>
#include <wallfree/api/json.h>

ZTEST_SUITE(api_md5, NULL, NULL, NULL, NULL, NULL);
ZTEST_SUITE(api_digest, NULL, NULL, NULL, NULL, NULL);
ZTEST_SUITE(api_json, NULL, NULL, NULL, NULL, NULL);

static void md5s(const char *s, char out[33])
{
	struct wf_md5 c;
	uint8_t d[16];

	wf_md5_init(&c);
	wf_md5_update(&c, s, strlen(s));
	wf_md5_final(&c, d);
	wf_hex(d, 16, out);
}

/* Pruefvektoren RFC 1321 Anhang A.5 */
ZTEST(api_md5, test_rfc1321_vectors)
{
	static const char *const v[][2] = {
		{"", "d41d8cd98f00b204e9800998ecf8427e"},
		{"a", "0cc175b9c0f1b6a831c399e269772661"},
		{"abc", "900150983cd24fb0d6963f7d28e17f72"},
		{"message digest", "f96b697d7cb7938d525a2f31aaf161d0"},
		{"abcdefghijklmnopqrstuvwxyz", "c3fcd3d76192e4007dfb496cca67e13b"},
		{"ABCDEFGHIJKLMNOPQRSTUVWXYZabcdefghijklmnopqrstuvwxyz0123456789",
		 "d174ab98d277d9f5a5611c2c9f419d9f"},
		{"1234567890123456789012345678901234567890123456789012345678901234567890"
		 "1234567890",
		 "57edf4a22be3c955ac49da2e2107b67a"},
	};
	char h[33];

	for (size_t i = 0; i < ARRAY_SIZE(v); i++) {
		md5s(v[i][0], h);
		zassert_str_equal(h, v[i][1], "%zu", i);
	}
}

ZTEST(api_md5, test_incremental)
{
	struct wf_md5 c;
	uint8_t d[16];
	char h[33];
	const char *s = "ABCDEFGHIJKLMNOPQRSTUVWXYZabcdefghijklmnopqrstuvwxyz0123456789";

	wf_md5_init(&c);
	for (size_t i = 0; i < strlen(s); i += 7) {
		size_t k = strlen(s) - i < 7 ? strlen(s) - i : 7;

		wf_md5_update(&c, s + i, k);
	}
	wf_md5_final(&c, d);
	wf_hex(d, 16, h);
	zassert_str_equal(h, "d174ab98d277d9f5a5611c2c9f419d9f");
}

/* ------------------------------------------------ Digest */

static struct wf_digest_cfg cfg;

static void setup_cfg(const char *user, const char *realm, const char *pw)
{
	memset(&cfg, 0, sizeof(cfg));
	cfg.realm = realm;
	cfg.user = user;
	wf_digest_ha1(user, realm, pw, cfg.ha1);
	for (int i = 0; i < WF_DIGEST_SECRET; i++) {
		cfg.secret[i] = (uint8_t)(i * 13 + 7);
	}
}

/* Antwort wie ein Client (RFC 7616 3.4.1) */
static void client_header(char *out, size_t size, const char *user, const char *realm,
			  const char *pw, const char *nonce, const char *method, const char *uri,
			  const char *nc, const char *cnonce)
{
	char a1[160], a2[160], ha1[33], ha2[33], r[300], resp[33];

	snprintf(a1, sizeof(a1), "%s:%s:%s", user, realm, pw);
	md5s(a1, ha1);
	snprintf(a2, sizeof(a2), "%s:%s", method, uri);
	md5s(a2, ha2);
	snprintf(r, sizeof(r), "%s:%s:%s:%s:auth:%s", ha1, nonce, nc, cnonce, ha2);
	md5s(r, resp);
	snprintf(out, size,
		 "Digest username=\"%s\", realm=\"%s\", nonce=\"%s\", uri=\"%s\", "
		 "cnonce=\"%s\", nc=%s, qop=auth, response=\"%s\", algorithm=MD5",
		 user, realm, nonce, uri, cnonce, nc, resp);
}

static void nonce_from_challenge(const char *ch, char nonce[32])
{
	const char *p = strstr(ch, "nonce=\"");

	zassert_not_null(p);
	p += 7;
	size_t n = strcspn(p, "\"");

	zassert_true(n < 32);
	memcpy(nonce, p, n);
	nonce[n] = '\0';
}

/* Beispiel aus RFC 2617 3.5: Antwort stimmt, Nonce ist nicht von uns -> stale */
ZTEST(api_digest, test_rfc2617_example)
{
	setup_cfg("Mufasa", "testrealm@host.com", "Circle Of Life");
	const char *h = "Digest username=\"Mufasa\", realm=\"testrealm@host.com\", "
			"nonce=\"dcd98b7102dd2f0e8b11d0f600bfb0c093\", uri=\"/dir/index.html\", "
			"qop=auth, nc=00000001, cnonce=\"0a4f113b\", "
			"response=\"6629fae49393a05397450978507c4ef1\", "
			"opaque=\"5ccc069c403ebaf9f0171e9517f40e41\"";

	zassert_equal(wf_digest_check(&cfg, h, "GET", "/dir/index.html"), WF_AUTH_STALE);
	zassert_equal(wf_digest_check(&cfg, h, "POST", "/dir/index.html"), WF_AUTH_BAD);
	zassert_equal(wf_digest_check(&cfg, h, "GET", "/other"), WF_AUTH_BAD);
}

ZTEST(api_digest, test_roundtrip)
{
	char ch[200], nonce[32], h[400];

	setup_cfg("admin", WF_DIGEST_REALM, "geheim123");
	zassert_true(wf_digest_challenge(&cfg, 0x1234, false, ch, sizeof(ch)) > 0);
	zassert_not_null(strstr(ch, "Digest realm=\"wallfree\""));
	zassert_not_null(strstr(ch, "qop=\"auth\""));
	zassert_is_null(strstr(ch, "stale"));
	nonce_from_challenge(ch, nonce);
	zassert_equal(strlen(nonce), 24);

	client_header(h, sizeof(h), "admin", "wallfree", "geheim123", nonce, "GET", "/evse/state",
		      "00000001", "abcdef0123456789");
	zassert_equal(wf_digest_check(&cfg, h, "GET", "/evse/state"), WF_AUTH_OK);
	/* WebSocket-Aufbau mit vorab gesendeter Anmeldung (evcc) */
	client_header(h, sizeof(h), "admin", "wallfree", "geheim123", nonce, "GET", "/ws",
		      "00000002", "1122");
	zassert_equal(wf_digest_check(&cfg, h, "GET", "/ws"), WF_AUTH_OK);

	/* falsches Passwort, falscher Benutzer */
	client_header(h, sizeof(h), "admin", "wallfree", "falsch", nonce, "GET", "/evse/state",
		      "00000001", "abcd");
	zassert_equal(wf_digest_check(&cfg, h, "GET", "/evse/state"), WF_AUTH_BAD);
	client_header(h, sizeof(h), "root", "wallfree", "geheim123", nonce, "GET", "/evse/state",
		      "00000001", "abcd");
	zassert_equal(wf_digest_check(&cfg, h, "GET", "/evse/state"), WF_AUTH_BAD);

	/* Nonce eines frueheren Starts (anderes Geheimnis): stale */
	client_header(h, sizeof(h), "admin", "wallfree", "geheim123", nonce, "GET", "/evse/state",
		      "00000001", "abcd");
	cfg.secret[0] ^= 1;
	zassert_equal(wf_digest_check(&cfg, h, "GET", "/evse/state"), WF_AUTH_STALE);
	zassert_true(wf_digest_challenge(&cfg, 1, true, ch, sizeof(ch)) > 0);
	zassert_not_null(strstr(ch, "stale=true"));
}

ZTEST(api_digest, test_malformed)
{
	setup_cfg("admin", WF_DIGEST_REALM, "geheim123");
	zassert_equal(wf_digest_check(&cfg, NULL, "GET", "/"), WF_AUTH_MISSING);
	zassert_equal(wf_digest_check(&cfg, "", "GET", "/"), WF_AUTH_MISSING);
	zassert_equal(wf_digest_check(&cfg, "Basic YWRtaW46eA==", "GET", "/"), WF_AUTH_BAD);
	zassert_equal(wf_digest_check(&cfg, "Digest", "GET", "/"), WF_AUTH_BAD);
	zassert_equal(wf_digest_check(&cfg, "Digest username=\"admin", "GET", "/"), WF_AUTH_BAD);
	zassert_equal(wf_digest_check(&cfg, "Digest username", "GET", "/"), WF_AUTH_BAD);

	char big[400];

	memset(big, 'a', sizeof(big));
	memcpy(big, "Digest username=\"", 17);
	big[sizeof(big) - 1] = '\0';
	zassert_equal(wf_digest_check(&cfg, big, "GET", "/"), WF_AUTH_BAD, "zu lang");

	/* ohne qop (RFC 2069) und mit anderem Verfahren abgelehnt */
	zassert_equal(wf_digest_check(&cfg,
				      "Digest username=\"admin\", realm=\"wallfree\", nonce=\"x\", "
				      "uri=\"/\", response=\"00000000000000000000000000000000\"",
				      "GET", "/"),
		      WF_AUTH_BAD);
	zassert_equal(wf_digest_check(&cfg,
				      "Digest username=\"admin\", realm=\"wallfree\", nonce=\"x\", "
				      "uri=\"/\", qop=auth, nc=00000001, cnonce=\"c\", "
				      "algorithm=SHA-256, "
				      "response=\"00000000000000000000000000000000\"",
				      "GET", "/"),
		      WF_AUTH_BAD);
}

ZTEST(api_digest, test_challenge_buffer)
{
	char small[20];

	setup_cfg("admin", WF_DIGEST_REALM, "x");
	zassert_equal(wf_digest_challenge(&cfg, 1, false, small, sizeof(small)), -1);
}

/* ------------------------------------------------ JSON */

static char seen[8][32];
static struct wf_jval seen_v[8];
static int nseen;

static int collect(void *ctx, const char *key, const struct wf_jval *v)
{
	ARG_UNUSED(ctx);
	zassert_true(nseen < 8);
	strncpy(seen[nseen], key, sizeof(seen[0]) - 1);
	seen_v[nseen++] = *v;
	return 0;
}

static int parse(const char *s)
{
	char sb[128];

	nseen = 0;
	return wf_json_object(s, strlen(s), sb, sizeof(sb), collect, NULL);
}

ZTEST(api_json, test_object)
{
	zassert_equal(parse(" { \"a\" : 1, \"b\":-20000,\"c\":true,\"d\":false,\"e\":null,"
			    "\"f\":\"x\\\"y\\u0041\" } "),
		      0);
	zassert_equal(nseen, 6);
	zassert_str_equal(seen[0], "a");
	zassert_equal(seen_v[0].num, 1);
	zassert_equal(seen_v[1].num, -20000);
	zassert_equal(seen_v[2].type, WF_J_BOOL);
	zassert_equal(seen_v[2].num, 1);
	zassert_equal(seen_v[3].num, 0);
	zassert_equal(seen_v[4].type, WF_J_NULL);
	zassert_equal(seen_v[5].type, WF_J_STR);
	zassert_equal(parse("{}"), 0);
	zassert_equal(nseen, 0);
}

ZTEST(api_json, test_rejects)
{
	static const char *const bad[] = {
		"", "[]", "{", "{\"a\"}", "{\"a\":}", "{\"a\":1,}", "{\"a\":1} x", "{\"a\":1.5}",
		"{\"a\":1e3}", "{\"a\":{\"b\":1}}", "{\"a\":[1]}", "{\"a\":\"\\u00e4\"}",
		"{\"a\":\"\\q\"}", "{a:1}", "{\"a\":99999999999999999999}", "{\"a\":-}",
		"{\"a\":\"x\ny\"}",
	};

	for (size_t i = 0; i < ARRAY_SIZE(bad); i++) {
		zassert_equal(parse(bad[i]), -1, "%s", bad[i]);
	}
	/* Textpuffer zu klein */
	char sb[4];

	zassert_equal(wf_json_object("{\"abcdef\":1}", 12, sb, sizeof(sb), collect, NULL), -1);
}

ZTEST(api_json, test_number)
{
	int64_t v;

	zassert_equal(wf_json_number(" 16000 ", 7, &v), 0);
	zassert_equal(v, 16000);
	zassert_equal(wf_json_number("16000x", 6, &v), -1);
	zassert_equal(wf_json_number("", 0, &v), -1);
}

ZTEST(api_json, test_writer)
{
	char b[64];
	struct wf_jbuf j;

	wf_jb_init(&j, b, sizeof(b));
	wf_jb_raw(&j, "{");
	wf_jb_key(&j, "a\"b", true);
	wf_jb_str(&j, "x\\y\n");
	wf_jb_key(&j, "n", false);
	wf_jb_int(&j, -5);
	wf_jb_raw(&j, "}");
	zassert_false(j.overflow);
	zassert_str_equal(b, "{\"a\\\"b\":\"x\\\\y\\u000a\",\"n\":-5}");

	char s[8];

	wf_jb_init(&j, s, sizeof(s));
	wf_jb_str(&j, "zu lang fuer den Puffer");
	zassert_true(j.overflow);
	zassert_true(strlen(s) < sizeof(s));
}
```

## src/test_flashread.c
```c
/* SPDX-License-Identifier: Apache-2.0 */
/* Tests Lesen von Flash, OTP und Optionsbytes (SOLL-SH-24) */
#include <string.h>
#include <zephyr/ztest.h>
#include <wallfree/api/flashread.h>

ZTEST_SUITE(api_flashread, NULL, NULL, NULL, NULL, NULL);

ZTEST(api_flashread, test_ranges)
{
	/* Sektor 0..6 */
	zassert_equal(wf_flashread_check(0x08000000u, 1024), 0);
	zassert_equal(wf_flashread_check(0x0805FC00u, 1024), 0, "bis zum Ende von Sektor 6");
	zassert_equal(wf_flashread_check(0x0805FFFFu, 1), 0);
	/* Sektor 7 mit den Zugangsdaten nicht, auch nicht teilweise */
	zassert_equal(wf_flashread_check(0x0805FFFFu, 2), -2);
	zassert_equal(wf_flashread_check(0x08060000u, 1), -2);
	zassert_equal(wf_flashread_check(0x0807FFFFu, 1), -2);
	/* OTP und Optionsbytes */
	zassert_equal(wf_flashread_check(0x1FFF7800u, 528), 0);
	zassert_equal(wf_flashread_check(0x1FFF7800u, 529), -2);
	zassert_equal(wf_flashread_check(0x1FFFC000u, 16), 0);
	zassert_equal(wf_flashread_check(0x1FFFC000u, 17), -2);
	/* anderes: RAM, Peripherie, Systemspeicher, vor dem Flash */
	zassert_equal(wf_flashread_check(0x20000000u, 4), -2);
	zassert_equal(wf_flashread_check(0x40023C00u, 4), -2);
	zassert_equal(wf_flashread_check(0x1FFF0000u, 4), -2);
	zassert_equal(wf_flashread_check(0x07FFFFFFu, 2), -2);
	/* Laenge */
	zassert_equal(wf_flashread_check(0x08000000u, 0), -1);
	zassert_equal(wf_flashread_check(0x08000000u, 1025), -1);
	/* Ueberlauf am Adressende */
	zassert_equal(wf_flashread_check(0xFFFFFFFFu, 2), -2);
}

ZTEST(api_flashread, test_base64)
{
	char out[16];

	/* RFC 4648 Abschnitt 10 */
	zassert_equal(wf_base64((const uint8_t *)"", 0, out, sizeof(out)), 0);
	zassert_str_equal(out, "");
	zassert_equal(wf_base64((const uint8_t *)"f", 1, out, sizeof(out)), 4);
	zassert_str_equal(out, "Zg==");
	wf_base64((const uint8_t *)"fo", 2, out, sizeof(out));
	zassert_str_equal(out, "Zm8=");
	wf_base64((const uint8_t *)"foo", 3, out, sizeof(out));
	zassert_str_equal(out, "Zm9v");
	wf_base64((const uint8_t *)"foobar", 6, out, sizeof(out));
	zassert_str_equal(out, "Zm9vYmFy");

	const uint8_t bin[] = {0x00, 0xFF, 0xFE};

	wf_base64(bin, sizeof(bin), out, sizeof(out));
	zassert_str_equal(out, "AP/+");
	/* zu kleiner Puffer */
	zassert_equal(wf_base64((const uint8_t *)"foobar", 6, out, 8), 0);
}
```

## src/test_ha.c
```c
/* SPDX-License-Identifier: Apache-2.0 */
/* Tests Home-Assistant-Erkennung (SOLL-MQTT-40..42) */
#include <string.h>
#include <zephyr/ztest.h>
#include <wallfree/api/ha.h>

ZTEST_SUITE(api_ha, NULL, NULL, NULL, NULL, NULL);

static char topic[WF_HA_TOPIC_MAX];
static char buf[WF_HA_PAYLOAD_MAX];

static int gen(int i, const struct wf_ha_ctx *c)
{
	struct wf_jbuf b;

	wf_jb_init(&b, buf, sizeof(buf));
	return wf_ha_config(i, c, topic, sizeof(topic), &b);
}

/* Wertvorlage vollstaendig: "{{ ... }}" (Testgeraet 2026-10-27: Zustand war auf 96 Byte gekuerzt) */
static void check_tpl(void)
{
	const char *t = strstr(buf, "\"val_tpl\":\"{{ ");
	const char *end;

	zassert_not_null(t, "%s", buf);
	end = strchr(t + 11, '"');
	zassert_not_null(end);
	zassert_true(end - t > 14 && strncmp(end - 3, " }}", 3) == 0, "%.*s", (int)(end - t), t);
}

ZTEST(api_ha, test_configs)
{
	const struct wf_ha_ctx c = {.base = "wallfree/a1b2c3", .node = "wallfree_a1b2c3",
				    .name = "Wallfree a1b2c3", .version = "0.1+2e0fb17",
				    .commands = false, .power_idx = -1, .energy_idx = -1};
	int made = 0, removed = 0, i;

	for (i = 0; gen(i, &c) >= 0; i++) {
		zassert_true(strncmp(topic, "homeassistant/", 14) == 0, "%s", topic);
		zassert_not_null(strstr(topic, "/wallfree_a1b2c3/"), "%s", topic);
		zassert_true(strcmp(topic + strlen(topic) - 7, "/config") == 0);
		if (gen(i, &c) == 1) {
			made++;
			zassert_not_null(strstr(buf, "\"~\":\"wallfree/a1b2c3\""));
			zassert_not_null(strstr(buf, "\"avty_t\":\"~/online\""));
			zassert_not_null(strstr(buf, "\"ids\":[\"wallfree_a1b2c3\"]"));
			zassert_not_null(strstr(buf, "\"uniq_id\":\"wallfree_a1b2c3_"));
			check_tpl();
		} else {
			removed++;
		}
	}
	zassert_equal(made, 6, "Zustand, angeschlossen, laedt, Fehler, erlaubt, Vorgabe");
	zassert_equal(removed, 3, "ohne Befehle und Zaehler: Ladestrom, Leistung, Energie entfallen");

	zassert_equal(gen(0, &c), 1);
	zassert_str_equal(topic, "homeassistant/sensor/wallfree_a1b2c3/state/config");
	zassert_not_null(strstr(buf, "\"stat_t\":\"~/evse/state\""));
	zassert_not_null(strstr(buf, "Lädt"), "Texte in UTF-8");
}

ZTEST(api_ha, test_commands_and_meter)
{
	const struct wf_ha_ctx c = {.base = "wb", .node = "wallfree_a1b2c3", .name = "W",
				    .version = "x", .commands = true, .power_idx = 7,
				    .energy_idx = 9};
	int i, n = 0;

	for (i = 0; gen(i, &c) >= 0; i++) {
		n += gen(i, &c) == 1;
		check_tpl();
		if (strstr(topic, "/number/") != NULL) {
			zassert_not_null(strstr(buf, "\"min\":0,\"max\":80,"), "ohne Drehschalter 80 A");
			zassert_not_null(strstr(buf, "\"cmd_t\":\"~/evse/external_current_update\""));
			zassert_not_null(strstr(buf, "\"cmd_tpl\":\"{{ (value * 1000) | int }}\""));
		}
		if (strstr(topic, "/power/") != NULL) {
			zassert_not_null(strstr(buf, "value_json[7]"));
			zassert_not_null(strstr(buf, "\"unit_of_meas\":\"W\""));
		}
		if (strstr(topic, "/energy/") != NULL) {
			zassert_not_null(strstr(buf, "value_json[9]"));
			zassert_not_null(strstr(buf, "\"stat_cla\":\"total_increasing\""));
		}
	}
	zassert_equal(n, 9, "alle Elemente");
	zassert_equal(gen(-1, &c), -1);
}

/* Obergrenze des Zahlenfelds = Maximum des Drehschalters (Testgeraet: 16 A) */
ZTEST(api_ha, test_max_from_rotary)
{
	const struct wf_ha_ctx c = {.base = "wb", .node = "wallfree_a1b2c3", .name = "W",
				    .version = "x", .commands = true, .max_a = 16, .power_idx = -1,
				    .energy_idx = -1};

	for (int i = 0; gen(i, &c) >= 0; i++) {
		if (strstr(topic, "/number/") != NULL) {
			zassert_equal(gen(i, &c), 1);
			zassert_not_null(strstr(buf, "\"min\":0,\"max\":16,\"step\":1"), "%s", buf);
			return;
		}
	}
	ztest_test_fail();
}

/* groesste Nutzdaten mit dem laengsten zulaessigen Praefix (64 Zeichen) passen */
ZTEST(api_ha, test_size)
{
	static const char base[] =
		"aaaaaaaaaaaaaaaaaaaaaaaaaaaaaaaaaaaaaaaaaaaaaaaaaaaaaaaaaaaaaaaa";
	const struct wf_ha_ctx c = {.base = base, .node = "wallfree_a1b2c3",
				    .name = "wallfree-1234567890123456789012345", .version = "0.2-dev+2e0fb17-dirty",
				    .commands = true, .power_idx = 7, .energy_idx = 9};

	zassert_equal(strlen(base), 64);
	for (int i = 0; gen(i, &c) >= 0; i++) {
		zassert_equal(gen(i, &c), 1, "Element %d passt nicht", i);
	}
}
```

## src/test_history.c
```c
/* SPDX-License-Identifier: Apache-2.0 */
/* Tests Verlauf (SOLL-API-33) */
#include <string.h>
#include <zephyr/ztest.h>
#include <wallfree/api/history.h>

#define IV WF_HIST_INTERVAL_MS

static struct wf_hist h;

static void before(void *f)
{
	ARG_UNUSED(f);
	wf_hist_init(&h);
}

ZTEST_SUITE(api_history, NULL, NULL, before, NULL, NULL);

ZTEST(api_history, test_mean_per_interval)
{
	struct wf_hist_row r;

	zassert_false(wf_hist_current(&h, &r));
	wf_hist_add(&h, 0, 1000, 16000, WF_HIST_CONNECTED);
	wf_hist_add(&h, 1000, 3000, 6000, WF_HIST_CONNECTED | WF_HIST_CHARGING);
	zassert_equal(wf_hist_len(&h), 0, "Intervall laeuft noch");
	zassert_true(wf_hist_current(&h, &r));
	zassert_equal(r.power_w, 2000);
	zassert_equal(r.allowed, 44, "11 A in 0,25 A");
	zassert_equal(r.flags, WF_HIST_CONNECTED | WF_HIST_CHARGING, "ODER");

	wf_hist_add(&h, IV, 0, 0, 0);
	zassert_equal(wf_hist_len(&h), 1);
	zassert_true(wf_hist_get(&h, 0, &r));
	zassert_equal(r.power_w, 2000);
	zassert_false(wf_hist_get(&h, 1, &r));
	zassert_equal(h.end_ms, IV);
	zassert_true(wf_hist_current(&h, &r));
	zassert_equal(r.flags, 0, "neues Intervall beginnt leer");
}

ZTEST(api_history, test_invalid_power_ignored)
{
	struct wf_hist_row r;

	wf_hist_add(&h, 0, -1, 0, 0);
	wf_hist_add(&h, 1, 500, 0, 0);
	wf_hist_add(&h, IV, -1, 0, 0);
	wf_hist_add(&h, 2 * IV, -1, 0, 0);
	zassert_true(wf_hist_get(&h, 0, &r));
	zassert_equal(r.power_w, 500, "nur gueltige Werte im Mittel");
	zassert_true(wf_hist_get(&h, 1, &r));
	zassert_equal(r.power_w, WF_HIST_NO_POWER);
}

ZTEST(api_history, test_gap_and_wrap)
{
	struct wf_hist_row r;

	wf_hist_add(&h, 0, 100, 0, 0);
	wf_hist_add(&h, 3 * IV, 0, 0, 0);
	zassert_equal(wf_hist_len(&h), 3, "zwei leere Intervalle nachgetragen");
	zassert_true(wf_hist_get(&h, 1, &r));
	zassert_equal(r.power_w, WF_HIST_NO_POWER);

	for (int i = 0; i < WF_HIST_SIZE + 5; i++) {
		wf_hist_add(&h, (4 + i) * (int64_t)IV, i, 0, 0);
	}
	zassert_equal(wf_hist_len(&h), WF_HIST_SIZE);
	zassert_true(wf_hist_get(&h, WF_HIST_SIZE - 1, &r));
	zassert_equal(r.power_w, WF_HIST_SIZE + 3, "juengste Zeile zuletzt");
	zassert_true(wf_hist_get(&h, 0, &r));
	zassert_equal(r.power_w, 4, "aelteste herausgefallen");

	wf_hist_add(&h, 0, 1, 0, 0);
	zassert_equal(wf_hist_len(&h), WF_HIST_SIZE, "rueckwaerts ignoriert");
}

ZTEST(api_history, test_json_small)
{
	char buf[256];
	struct wf_jbuf b;

	wf_jb_init(&b, buf, sizeof(buf));
	zassert_equal(wf_hist_json(&h, 5, 0, &b), WF_HIST_DONE);
	zassert_str_equal(buf, "{\"interval_ms\":600000,\"rows\":[],\"age_ms\":5,\"current\":null}");

	wf_hist_add(&h, 0, 1520, 16000, 3);
	wf_hist_add(&h, IV, -1, 0, 0);
	wf_jb_init(&b, buf, sizeof(buf));
	zassert_equal(wf_hist_json(&h, IV + 7, 0, &b), WF_HIST_DONE);
	zassert_str_equal(buf, "{\"interval_ms\":600000,\"rows\":[[1520,16000,3]],\"age_ms\":7,"
			       "\"current\":[null,0,0]}");
}

/* Teile zusammengesetzt = ein Stueck; ein Intervallende zwischen zwei Teilen haengt an */
ZTEST(api_history, test_json_chunks)
{
	static char all[16384];
	char part[128];
	struct wf_jbuf b;
	uint32_t cur = 0;
	int parts = 0;

	for (int i = 0; i <= WF_HIST_SIZE + 10; i++) {
		wf_hist_add(&h, (int64_t)i * IV, 22000, 32000, 7);
	}
	all[0] = '\0';
	do {
		wf_jb_init(&b, part, sizeof(part));
		cur = wf_hist_json(&h, 0, cur, &b);
		zassert_false(b.overflow);
		strcat(all, part);
		if (parts++ == 3) {
			wf_hist_add(&h, (int64_t)(WF_HIST_SIZE + 11) * IV, 0, 0, 0);
		}
	} while (cur != WF_HIST_DONE);
	zassert_true(parts > 20);
	zassert_not_null(strstr(all, "{\"interval_ms\":600000,\"rows\":[[22000,32000,7],[22000"));
	zassert_not_null(strstr(all, "[22000,32000,7],[22000,32000,7]],\"age_ms\":"), "%s", all);
	zassert_is_null(strstr(all, ",,"));
	zassert_is_null(strstr(all, "[,"));
	int rows = 0;

	for (const char *p = strstr(all, "\"rows\":[") + 8; *p && *p != '"'; p++) {
		rows += *p == '[';
	}
	zassert_equal(rows, WF_HIST_SIZE + 1, "eine Zeile waehrend der Ausgabe dazugekommen");
}
```

## src/test_mqtt.c
```c
/* SPDX-License-Identifier: Apache-2.0 */
/* Tests MQTT ohne Netzwerk (12.6: SOLL-MQTT-10/11/20/22/30) */
#include <string.h>
#include <zephyr/ztest.h>
#include <wallfree/api/mqtt.h>

ZTEST_SUITE(api_mqtt, NULL, NULL, NULL, NULL, NULL);

ZTEST(api_mqtt, test_topic_name)
{
	char t[27];

	zassert_equal(wf_mq_topic_name(t, sizeof(t), "wallfree/a1b2c3", "evse/state"), 26);
	zassert_str_equal(t, "wallfree/a1b2c3/evse/state");
	zassert_equal(wf_mq_topic_name(t, sizeof(t), "wallfree/a1b2c3", "evse/limits"), -1,
		      "zu lang");
	zassert_equal(wf_mq_topic_name(t, sizeof(t), "w", "online"), 8);
	zassert_str_equal(t, "w/online");
}

/* SOLL-MQTT-11: Vollversand nach Verbinden, Aenderung, Mindestabstand, Nachholen */
ZTEST(api_mqtt, test_send_rule)
{
	struct wf_mq_topic t = {0};
	uint32_t a = wf_mq_hash("{\"a\":1}", 7), b = wf_mq_hash("{\"a\":2}", 7);

	zassert_not_equal(a, b);
	wf_mq_reset(&t);
	wf_mq_update(&t, a);
	zassert_true(wf_mq_due(&t, 0, 1000), "nach Verbinden sofort");
	wf_mq_sent(&t, a, 0);
	wf_mq_update(&t, a);
	zassert_false(wf_mq_due(&t, 5000, 1000), "unveraendert");

	wf_mq_update(&t, b);
	zassert_true(wf_mq_due(&t, 5000, 1000), "Aenderung nach Ablauf");
	wf_mq_sent(&t, b, 5000);
	wf_mq_update(&t, a);
	zassert_false(wf_mq_due(&t, 5500, 1000), "Mindestabstand");
	wf_mq_update(&t, b); /* zurueck auf den gesendeten Stand: bleibt ausstehend */
	zassert_true(wf_mq_due(&t, 6000, 1000), "nachgeholt mit dem dann aktuellen Stand");
	wf_mq_sent(&t, b, 6000);
	zassert_false(wf_mq_due(&t, 9000, 1000));

	/* Intervall 0: jede Aenderung sofort */
	wf_mq_update(&t, a);
	zassert_true(wf_mq_due(&t, 6000, 0));

	/* Zaehlerzyklus ohne Vergleich */
	wf_mq_sent(&t, a, 6000);
	wf_mq_touch(&t);
	zassert_false(wf_mq_due(&t, 6999, 1000));
	zassert_true(wf_mq_due(&t, 7000, 1000));

	/* neue Verbindung: sofort, ohne Bremse */
	wf_mq_sent(&t, a, 7000);
	wf_mq_reset(&t);
	zassert_true(wf_mq_due(&t, 7001, 1000));
}

struct fake {
	int calls;
	char last[WF_MQ_PAYLOAD_MAX + 1];
};

static const char *h_current(void *ctx, const char *payload, size_t len)
{
	struct fake *f = ctx;

	f->calls++;
	memcpy(f->last, payload, len);
	f->last[len] = '\0';
	return strcmp(f->last, "5") == 0 ? "ungueltig" : NULL;
}

static const char *h_other(void *ctx, const char *payload, size_t len)
{
	ARG_UNUSED(payload);
	ARG_UNUSED(len);
	((struct fake *)ctx)->calls += 100;
	return NULL;
}

static const struct wf_mq_cmd cmds[] = {
	{"evse/external_current_update", h_current},
	{"evse/other", h_other},
};

static enum wf_mq_in in(struct fake *f, const char *topic, const char *payload, size_t len,
			bool retained, const char **err)
{
	return wf_mq_dispatch(cmds, ARRAY_SIZE(cmds), "wf/1", topic, strlen(topic), payload, len,
			      retained, f, err);
}

/* SOLL-MQTT-20/22 */
ZTEST(api_mqtt, test_dispatch)
{
	struct fake f = {0};
	const char *err = NULL;
	char big[WF_MQ_PAYLOAD_MAX + 1];

	zassert_equal(in(&f, "wf/1/evse/external_current_update", "16000", 5, false, &err),
		      WF_MQ_IN_OK);
	zassert_is_null(err);
	zassert_equal(f.calls, 1);
	zassert_str_equal(f.last, "16000");
	zassert_equal(in(&f, "wf/1/evse/other", "1", 1, false, &err), WF_MQ_IN_OK);
	zassert_equal(f.calls, 101, "zweiter Tabelleneintrag");

	zassert_equal(in(&f, "wf/1/evse/external_current_update", "5", 1, false, &err),
		      WF_MQ_IN_REJECTED);
	zassert_str_equal(err, "ungueltig");
	zassert_equal(in(&f, "wf/1/evse/external_current_update", "16000", 5, true, &err),
		      WF_MQ_IN_RETAINED);
	zassert_equal(in(&f, "wf/1/evse/external_current_update", "", 0, false, &err),
		      WF_MQ_IN_EMPTY);
	memset(big, '1', sizeof(big));
	zassert_equal(in(&f, "wf/1/evse/external_current_update", big, WF_MQ_PAYLOAD_MAX, false,
			 &err), WF_MQ_IN_OK, "128 Byte gehen");
	zassert_equal(in(&f, "wf/1/evse/external_current_update", NULL, WF_MQ_PAYLOAD_MAX + 1,
			 false, &err), WF_MQ_IN_TOO_LONG);
	zassert_equal(f.calls, 103, "Ignoriertes erreicht die Behandlung nicht");

	static const char *const unknown[] = {"wf/1/evse/external_current", "wf/2/evse/other",
					      "wf/1evse/other", "wf/1/evse/other/x", "wf/1/",
					      "wf/1", "evse/other"};

	for (size_t i = 0; i < ARRAY_SIZE(unknown); i++) {
		zassert_equal(in(&f, unknown[i], "1", 1, false, &err), WF_MQ_IN_UNKNOWN, "%s",
			      unknown[i]);
	}
	zassert_equal(f.calls, 103);
}

/* SOLL-MQTT-30 */
ZTEST(api_mqtt, test_status)
{
	struct wf_mq_status s = {.conn = WF_MQ_CONNECTED, .start_ms = 1500, .last_error = -111,
				 .published = 7};
	char buf[320];
	struct wf_jbuf b;

	strcpy(s.prefix, "wallfree/a1b2c3");
	wf_mq_note_command(&s, WF_MQ_IN_OK, NULL);
	wf_mq_note_command(&s, WF_MQ_IN_RETAINED, "gespeicherte Nachricht (retained) ignoriert");
	wf_jb_init(&b, buf, sizeof(buf));
	wf_mq_status_json(&s, &b);
	zassert_false(b.overflow);
	zassert_str_equal(buf, "{\"connection_state\":2,\"connection_start\":1500,"
			       "\"connection_end\":0,\"last_error\":-111,\"published\":7,"
			       "\"publish_errors\":0,\"commands\":2,\"rejected\":1,"
			       "\"last_reject\":\"gespeicherte Nachricht (retained) ignoriert\","
			       "\"prefix\":\"wallfree/a1b2c3\"}");
}
```

## src/test_ntp.c
```c
/* SPDX-License-Identifier: Apache-2.0 */
/* Tests Uhrzeit per SNTP ohne Netz (SOLL-TIME-01..04) */
#include <string.h>
#include <zephyr/ztest.h>
#include <wallfree/api/ntp.h>
#include <wallfree/api/sysconf.h>

ZTEST_SUITE(api_ntp, NULL, NULL, NULL, NULL, NULL);

static int parse(const char *s, char *host, uint16_t *port)
{
	return wf_ntp_parse_server(s, strlen(s), host, port);
}

ZTEST(api_ntp, test_parse_server)
{
	char host[65];
	uint16_t port;

	zassert_equal(parse("pool.ntp.org", host, &port), 0);
	zassert_str_equal(host, "pool.ntp.org");
	zassert_equal(port, 123);
	zassert_equal(parse("192.168.1.1:1123", host, &port), 0);
	zassert_str_equal(host, "192.168.1.1");
	zassert_equal(port, 1123);
	zassert_equal(parse("fritz.box", host, &port), 0);
	static const char *const bad[] = {"", ":123", "a b", "host:", "host:0", "host:65536",
					  "host:123456", "host:12a", ".host", "host.", "-a", "a_b"};

	for (size_t i = 0; i < ARRAY_SIZE(bad); i++) {
		zassert_equal(parse(bad[i], host, &port), -1, "%s", bad[i]);
	}
}

ZTEST(api_ntp, test_next)
{
	zassert_equal(wf_ntp_next_s(0), 3600, "nach Erfolg stuendlich");
	zassert_equal(wf_ntp_next_s(1), 60);
	zassert_equal(wf_ntp_next_s(2), 120);
	zassert_equal(wf_ntp_next_s(6), 1920);
	zassert_equal(wf_ntp_next_s(7), 3600, "hoechstens stuendlich");
	zassert_equal(wf_ntp_next_s(1000), 3600);
}

ZTEST(api_ntp, test_epoch)
{
	zassert_equal(wf_ntp_epoch_ms(1793000000, 0x80000000u), 1793000000500);
	zassert_equal(wf_ntp_epoch_ms(0, 0), 0, "unplausibel (1970)");
	zassert_equal(wf_ntp_epoch_ms(1700000000, 0), 0, "vor 2025");
	zassert_equal(wf_ntp_epoch_ms(4102444800ull, 0), 0, "ab 2100");
}

ZTEST(api_ntp, test_rtc_kalender)
{
	struct wf_rtc_time t;

	wf_rtc_from_unix(1800000000ull, &t); /* Fr 2027-01-15 08:00:00 UTC */
	zassert_equal(t.year, 27);
	zassert_equal(t.month, 1);
	zassert_equal(t.day, 15);
	zassert_equal(t.weekday, 5, "Freitag");
	zassert_equal(t.hour, 8);
	zassert_equal(t.minute, 0);
	zassert_equal(t.second, 0);
	wf_rtc_from_unix(1835481599ull, &t); /* 2028-02-29 23:59:59 UTC, Schalttag */
	zassert_equal(t.month, 2);
	zassert_equal(t.day, 29);
	zassert_equal(t.hour, 23);
	zassert_equal(t.second, 59);
	for (uint64_t s = WF_NTP_MIN_EPOCH; s < WF_NTP_MAX_EPOCH; s += 86400ull * 13 + 4567) {
		wf_rtc_from_unix(s, &t);
		zassert_equal(wf_rtc_to_unix(&t), s, "Rundlauf %llu", s);
	}
}

ZTEST(api_ntp, test_rtc_unplausibel)
{
	struct wf_rtc_time t = {.year = 0, .month = 1, .day = 1, .weekday = 6};

	zassert_equal(wf_rtc_to_unix(&t), 0, "Kalender nie gestellt: 2000");
	t.year = 24;
	t.month = 12;
	t.day = 31;
	zassert_equal(wf_rtc_to_unix(&t), 0, "vor 2025");
	t.year = 27;
	t.month = 13;
	zassert_equal(wf_rtc_to_unix(&t), 0, "Monat");
	t.month = 1;
	t.hour = 24;
	zassert_equal(wf_rtc_to_unix(&t), 0, "Stunde");
}

ZTEST(api_ntp, test_rtc_register)
{
	/* Register des Testgeraets 2026-11-07 (SWD): Jahr in DR 23..16, Tag in 5..0 */
	struct wf_rtc_time t;

	wf_rtc_from_regs(0x00181459u, 0x0026D107u, &t);
	zassert_equal(t.year, 26);
	zassert_equal(t.month, 11);
	zassert_equal(t.day, 7);
	zassert_equal(t.weekday, 6);
	zassert_equal(t.hour, 18);
	zassert_equal(t.minute, 14);
	zassert_equal(t.second, 59);
	zassert_equal(wf_rtc_to_unix(&t), 1794075299ull);
	/* Rundlauf ueber die Registerform wie beim Stellen mit LL_RTC_DATE_Config */
	wf_rtc_from_unix(1800000000ull, &t);
	uint32_t dr = ((uint32_t)(t.year / 10u) << 20) | ((uint32_t)(t.year % 10u) << 16) |
		      ((uint32_t)t.weekday << 13) | ((uint32_t)(t.month / 10u) << 12) |
		      ((uint32_t)(t.month % 10u) << 8) | ((uint32_t)(t.day / 10u) << 4) |
		      (t.day % 10u);
	uint32_t tr = ((uint32_t)(t.hour / 10u) << 20) | ((uint32_t)(t.hour % 10u) << 16) |
		      ((uint32_t)(t.minute / 10u) << 12) | ((uint32_t)(t.minute % 10u) << 8) |
		      ((uint32_t)(t.second / 10u) << 4) | (t.second % 10u);
	struct wf_rtc_time r;

	wf_rtc_from_regs(tr, dr, &r);
	zassert_equal(wf_rtc_to_unix(&r), 1800000000ull);
}

/* Parameter: Werkszustand an, Server automatisch; Pruefung beim Setzen */
ZTEST(api_ntp, test_sysconf)
{
	struct wf_sysconf c;
	const struct wf_syspar *p = wf_sys_find("ntp_server");

	wf_sysconf_defaults(&c);
	zassert_true(c.ntp_enable);
	zassert_str_equal(c.ntp_server, "");
	zassert_not_null(p);
	zassert_is_null(wf_sys_set(&c, p, &(struct wf_jval){.type = WF_J_STR, .str = "ptbtime1.ptb.de",
							   .str_len = 15}));
	zassert_str_equal(c.ntp_server, "ptbtime1.ptb.de");
	zassert_not_null(wf_sys_set(&c, p, &(struct wf_jval){.type = WF_J_STR, .str = "a b",
							     .str_len = 3}));
	zassert_is_null(wf_sys_set(&c, p, &(struct wf_jval){.type = WF_J_STR, .str = "",
							   .str_len = 0}));
	zassert_true(wf_sys_find("ntp_server")->id >= WF_SYS_ID_LIVE, "wirkt sofort");
}
```

## src/test_ratelimit.c
```c
/* SPDX-License-Identifier: Apache-2.0 */
/* Tests Bremse gegen Passwort-Durchprobieren (SOLL-API-07) */
#include <zephyr/ztest.h>
#include <wallfree/api/ratelimit.h>

static struct wf_rl rl;

static void before(void *f)
{
	ARG_UNUSED(f);
	wf_rl_init(&rl);
}

ZTEST_SUITE(api_ratelimit, NULL, NULL, before, NULL, NULL);

#define A 0x0A000001
#define B 0x0A000002

ZTEST(api_ratelimit, test_free_attempts_then_lock)
{
	for (int i = 0; i < WF_RL_FREE - 1; i++) {
		wf_rl_fail(&rl, A, 1000);
		zassert_equal(wf_rl_blocked(&rl, A, 1000), 0, "Versuch %d frei", i + 1);
	}
	wf_rl_fail(&rl, A, 1000);
	zassert_equal(wf_rl_blocked(&rl, A, 1000), WF_RL_LOCK_MS);
	zassert_equal(wf_rl_blocked(&rl, B, 1000), 0, "andere Adresse nicht betroffen");
	zassert_equal(wf_rl_blocked(&rl, A, 1000 + WF_RL_LOCK_MS), 0, "Sperre abgelaufen");

	/* jeder weitere Fehlversuch verdoppelt bis zum Hoechstwert */
	int64_t t = 1000 + WF_RL_LOCK_MS;

	wf_rl_fail(&rl, A, t);
	zassert_equal(wf_rl_blocked(&rl, A, t), 2 * WF_RL_LOCK_MS);
	for (int i = 0; i < 20; i++) {
		wf_rl_fail(&rl, A, t);
	}
	zassert_equal(wf_rl_blocked(&rl, A, t), WF_RL_LOCK_MAX_MS);
}

ZTEST(api_ratelimit, test_success_resets)
{
	for (int i = 0; i < WF_RL_FREE - 1; i++) {
		wf_rl_fail(&rl, A, 0);
	}
	wf_rl_ok(&rl, A);
	wf_rl_fail(&rl, A, 0);
	zassert_equal(wf_rl_blocked(&rl, A, 0), 0);
}

ZTEST(api_ratelimit, test_forget_after_quiet_hour)
{
	for (int i = 0; i < WF_RL_FREE - 1; i++) {
		wf_rl_fail(&rl, A, 0);
	}
	wf_rl_fail(&rl, A, WF_RL_FORGET_MS + 1);
	zassert_equal(wf_rl_blocked(&rl, A, WF_RL_FORGET_MS + 1), 0, "Zaehler verfallen");
}

ZTEST(api_ratelimit, test_table_full_keeps_locked_entries)
{
	/* A sperren */
	for (int i = 0; i < WF_RL_FREE; i++) {
		wf_rl_fail(&rl, A, 100);
	}
	/* viele andere Adressen mit je einem Fehlversuch, spaeter */
	for (uint32_t k = 0; k < 3 * WF_RL_SLOTS; k++) {
		wf_rl_fail(&rl, 0x0B000000 + k, 200 + k);
	}
	zassert_true(wf_rl_blocked(&rl, A, 300) > 0, "gesperrter Eintrag wird nicht verdraengt");
}
```

## src/test_reset.c
```c
/* SPDX-License-Identifier: Apache-2.0 */
/* Tests Resetgrund (SOLL-RT-14) */
#include <string.h>
#include <zephyr/ztest.h>
#include <wallfree/api/reset.h>

ZTEST_SUITE(api_reset, NULL, NULL, NULL, NULL, NULL);

ZTEST(api_reset, test_classify)
{
	const uint32_t pin = WF_RSTF_PIN;

	zassert_equal(wf_reset_classify(WF_RSTF_POR | WF_RSTF_BOR | pin, 0), WF_RST_POWER);
	zassert_equal(wf_reset_classify(WF_RSTF_BOR | pin, 0), WF_RST_BROWNOUT);
	zassert_equal(wf_reset_classify(pin, 0), WF_RST_PIN);
	zassert_equal(wf_reset_classify(WF_RSTF_IWDG | pin, 0), WF_RST_IWDG);
	zassert_equal(wf_reset_classify(WF_RSTF_IWDG | WF_RSTF_SFT | pin,
					wf_reset_bkp_value(WF_RST_USER)),
		      WF_RST_IWDG, "Watchdog hat Vorrang");
	zassert_equal(wf_reset_classify(WF_RSTF_WWDG, 0), WF_RST_WWDG);
	zassert_equal(wf_reset_classify(WF_RSTF_LPWR, 0), WF_RST_LOWPOWER);
	zassert_equal(wf_reset_classify(0, 0), WF_RST_UNKNOWN);

	/* Software-Reset mit und ohne Code */
	for (enum wf_reset r = WF_RST_LIMIT; r < WF_RST_COUNT; r++) {
		zassert_equal(wf_reset_classify(WF_RSTF_SFT | pin, wf_reset_bkp_value(r)), r);
	}
	zassert_equal(wf_reset_classify(WF_RSTF_SFT, 0), WF_RST_SOFT);
	zassert_equal(wf_reset_classify(WF_RSTF_SFT, 0x12340009), WF_RST_SOFT, "fremder Inhalt");
	zassert_equal(wf_reset_classify(WF_RSTF_SFT, wf_reset_bkp_value(WF_RST_POWER)), WF_RST_SOFT,
		      "nur Software-Codes");
	/* Code ohne Software-Reset (z. B. Stromausfall danach): ignoriert */
	zassert_equal(wf_reset_classify(WF_RSTF_POR, wf_reset_bkp_value(WF_RST_USER)), WF_RST_POWER);
}

ZTEST(api_reset, test_names)
{
	for (enum wf_reset r = 0; r < WF_RST_COUNT; r++) {
		zassert_not_equal(strlen(wf_reset_name(r)), 0);
	}
	zassert_str_equal(wf_reset_name(WF_RST_USER), "user_restart");
	zassert_str_equal(wf_reset_name(WF_RST_UPDATE), "update");
	zassert_str_equal(wf_reset_name(WF_RST_COUNT), "unknown");
}

/* SOLL-RT-14: genauerer Ausloeser im zweiten Backup-Register */
ZTEST(api_reset, test_detail)
{
	unsigned int extra;

	zassert_equal(wf_reset_detail_decode(0, &extra), WF_RSTD_NONE);
	zassert_equal(wf_reset_detail_decode(0xFA000003u, &extra), WF_RSTD_NONE, "fremde Kennung");
	zassert_equal(wf_reset_detail_decode(wf_reset_detail_bkp(WF_RSTD_COUNT, 0), &extra),
		      WF_RSTD_NONE);
	zassert_equal(wf_reset_detail_decode(wf_reset_detail_bkp(WF_RSTD_CHARGER, 0), &extra),
		      WF_RSTD_CHARGER);
	zassert_equal(wf_reset_detail_decode(wf_reset_detail_bkp(WF_RSTD_FAULT, 0x1234), &extra),
		      WF_RSTD_FAULT);
	zassert_equal(extra, 0x34, "Zusatz 8 Bit");
	zassert_str_equal(wf_reset_detail_name(WF_RSTD_BLOCKS), "measurement_blocks");
	zassert_str_equal(wf_reset_detail_name(WF_RSTD_IFACE_HTTP), "http_server");
	zassert_str_equal(wf_reset_detail_name(WF_RSTD_NONE), "");
	zassert_str_equal(wf_reset_detail_name(WF_RSTD_COUNT), "");
}
```
