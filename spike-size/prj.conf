## CMakeLists.txt
```
# SPDX-License-Identifier: Apache-2.0
# Groessentest: Zephyr-Grundausstattung fuer die Ersatzfirmware (nur Build, nicht flashen)
cmake_minimum_required(VERSION 3.20.0)
list(APPEND BOARD_ROOT ${CMAKE_CURRENT_SOURCE_DIR}/..)
find_package(Zephyr REQUIRED HINTS $ENV{ZEPHYR_BASE})
project(spike_size)
target_sources(app PRIVATE src/main.c)
zephyr_linker_sources(SECTIONS sections-rom.ld)
zephyr_linker_section(NAME http_resource_desc_api KVMA RAM_REGION GROUP RODATA_REGION)
```

## prj.conf
```kconfig
# SPDX-License-Identifier: Apache-2.0
# Groessentest Ersatzfirmware: Netzwerk, HTTP, Telnet-Shell, Parameter, ADC, PWM, Watchdog
CONFIG_MAIN_STACK_SIZE=2048
CONFIG_HEAP_MEM_POOL_SIZE=16384
CONFIG_POSIX_API=n

# Netzwerk (IPv4, DHCP, TCP, Sockets) ueber den Zephyr-Stack
CONFIG_NETWORKING=y
CONFIG_NET_IPV4=y
CONFIG_NET_IPV6=n
CONFIG_NET_TCP=y
CONFIG_NET_UDP=y
CONFIG_NET_DHCPV4=y
CONFIG_NET_SOCKETS=y
CONFIG_NET_CONFIG_SETTINGS=y
CONFIG_NET_CONFIG_NEED_IPV4=y
CONFIG_NET_MAX_CONN=10
CONFIG_NET_MAX_CONTEXTS=10
CONFIG_ZVFS_OPEN_MAX=16
CONFIG_ZVFS_POLL_MAX=16
CONFIG_NET_HOSTNAME_ENABLE=y
CONFIG_NET_HOSTNAME="evcc"
CONFIG_ETH_DRIVER=y
CONFIG_NET_L2_ETHERNET=y

# HTTP-Server (REST-API-Grundlage)
CONFIG_HTTP_SERVER=y
CONFIG_HTTP_PARSER=y
CONFIG_HTTP_PARSER_URL=y
CONFIG_HTTP_SERVER_MAX_CLIENTS=3
CONFIG_HTTP_SERVER_MAX_STREAMS=3
CONFIG_JSON_LIBRARY=y

# Shell ueber Telnet (Nutzerwunsch), dazu Kern-/Netz-Kommandos
CONFIG_SHELL=y
CONFIG_SHELL_BACKEND_SERIAL=n
CONFIG_SHELL_BACKEND_TELNET=y
CONFIG_NET_SHELL=y
CONFIG_KERNEL_SHELL=y
CONFIG_LOG=y
CONFIG_LOG_BACKEND_UART=n

# Parameter in eigenem Flash-Bereich (Sektor 7) ueber ZMS
CONFIG_FLASH=y
CONFIG_FLASH_MAP=y
CONFIG_ZMS=y
CONFIG_SETTINGS=y
CONFIG_SETTINGS_ZMS=y
CONFIG_SETTINGS_RUNTIME=y

# Peripherie der Ladelogik
CONFIG_ADC=y
CONFIG_PWM=y
CONFIG_WATCHDOG=y
CONFIG_HWINFO=y
```

## app.overlay
```dts
/* SPDX-License-Identifier: Apache-2.0 */
/* Groessentest: Zephyr-PWM- und ADC-Treiber wie beim Messen am 2026-10-19.
 * Die eigentliche Anwendung (app/) steuert TIM1/ADC1 direkt und braucht das nicht. */
&timers1 {
	status = "okay";
	st,prescaler = <49>;

	pwm1: pwm {
		status = "okay";
		pinctrl-0 = <&tim1_ch1_pe9>;
		pinctrl-names = "default";
	};
};

&adc1 {
	status = "okay";
	pinctrl-0 = <&adc1_in0_pa0 &adc1_in9_pb1>;
	pinctrl-names = "default";
	st,adc-clock-source = "SYNC";
	st,adc-prescaler = <4>;
};
```

## src/main.c
```c
/* SPDX-License-Identifier: Apache-2.0 */
/*
 * Groessentest fuer die Ersatzfirmware (nur Build). Bindet die geplanten
 * Grundbausteine ein, damit Flash/RAM realistisch gemessen werden:
 * Netzwerk + DHCP, HTTP-Server mit JSON-Ressource, Telnet-Shell, Settings/ZMS,
 * ADC, PWM, Watchdog. Keine Ladelogik, keine Hardwarefreigabe.
 */
#include <zephyr/kernel.h>
#include <zephyr/device.h>
#include <zephyr/drivers/adc.h>
#include <zephyr/drivers/pwm.h>
#include <zephyr/drivers/watchdog.h>
#include <zephyr/net/http/server.h>
#include <zephyr/net/http/service.h>
#include <zephyr/data/json.h>
#include <zephyr/settings/settings.h>
#include <zephyr/shell/shell.h>
#include <stdio.h>

static const struct device *const pwm_dev = DEVICE_DT_GET(DT_NODELABEL(pwm1));
static const struct device *const adc_dev = DEVICE_DT_GET(DT_NODELABEL(adc1));
static const struct device *const wdt_dev = DEVICE_DT_GET(DT_NODELABEL(iwdg));

static uint16_t current_dA = 160; /* Sollstrom in 0,1 A (Entscheidung 21) */
static int16_t cp_mv;

struct state_json {
	int current_dA;
	int cp_mv;
	int64_t uptime_ms;
};

static const struct json_obj_descr state_descr[] = {
	JSON_OBJ_DESCR_PRIM(struct state_json, current_dA, JSON_TOK_NUMBER),
	JSON_OBJ_DESCR_PRIM(struct state_json, cp_mv, JSON_TOK_NUMBER),
	JSON_OBJ_DESCR_PRIM(struct state_json, uptime_ms, JSON_TOK_NUMBER),
};

static int state_handler(struct http_client_ctx *client, enum http_transaction_status status,
			 const struct http_request_ctx *request_ctx,
			 struct http_response_ctx *response_ctx, void *user_data)
{
	static char buf[128];

	if (status == HTTP_SERVER_REQUEST_DATA_FINAL) {
		struct state_json s = {current_dA, cp_mv, k_uptime_get()};
		int ret = json_obj_encode_buf(state_descr, ARRAY_SIZE(state_descr), &s, buf,
					      sizeof(buf));
		if (ret < 0) {
			return ret;
		}
		response_ctx->body = buf;
		response_ctx->body_len = strlen(buf);
		response_ctx->final_chunk = true;
	}
	return 0;
}

static struct http_resource_detail_dynamic state_detail = {
	.common = {
		.type = HTTP_RESOURCE_TYPE_DYNAMIC,
		.bitmask_of_supported_http_methods = BIT(HTTP_GET),
	},
	.cb = state_handler,
};

static uint16_t api_port = 80;
HTTP_SERVICE_DEFINE(api, NULL, &api_port, 3, 5, NULL, NULL, NULL);
HTTP_RESOURCE_DEFINE(state_resource, api, "/evse/state", &state_detail);

static int set_current(const char *name, size_t len, settings_read_cb read_cb, void *arg)
{
	if (!strcmp(name, "current") && len == sizeof(current_dA)) {
		return read_cb(arg, &current_dA, len) == len ? 0 : -EINVAL;
	}
	return -ENOENT;
}
SETTINGS_STATIC_HANDLER_DEFINE(evse, "evse", NULL, set_current, NULL, NULL);

static int cmd_current(const struct shell *sh, size_t argc, char **argv)
{
	if (argc > 1) {
		current_dA = (uint16_t)strtoul(argv[1], NULL, 10);
		settings_save_one("evse/current", &current_dA, sizeof(current_dA));
	}
	shell_print(sh, "current %u (0,1 A)", current_dA);
	return 0;
}
SHELL_CMD_REGISTER(current, NULL, "Sollstrom in 0,1 A lesen/setzen", cmd_current);

int main(void)
{
	struct adc_channel_cfg ch = {
		.gain = ADC_GAIN_1, .reference = ADC_REF_INTERNAL,
		.acquisition_time = ADC_ACQ_TIME_DEFAULT, .channel_id = 0,
	};
	struct wdt_timeout_cfg wcfg = {.window.max = 1000, .flags = WDT_FLAG_RESET_SOC};
	int16_t sample;
	struct adc_sequence seq = {
		.channels = BIT(0), .buffer = &sample, .buffer_size = sizeof(sample),
		.resolution = 12,
	};
	int wdt_ch;

	settings_subsys_init();
	settings_load();
	adc_channel_setup(adc_dev, &ch);
	wdt_ch = wdt_install_timeout(wdt_dev, &wcfg);
	wdt_setup(wdt_dev, 0);
	http_server_start();

	while (1) {
		if (adc_read(adc_dev, &seq) == 0) {
			cp_mv = sample;
		}
		/* 1 kHz, Tastgrad aus Strom (Platzhalter fuer die Duty-Formel) */
		pwm_set(pwm_dev, 1, PWM_USEC(1000), PWM_USEC(current_dA * 1000 / 600), 0);
		wdt_feed(wdt_dev, wdt_ch);
		k_msleep(100);
	}
	return 0;
}
```
