## Kconfig
```kconfig
# SPDX-License-Identifier: Apache-2.0
config WALLFREE_EVSE
	bool "Wallfree Ladelogik (hardwareunabhaengig)"
	help
	  Ladelogik nach docs/soll-spezifikation.md. Reines C ohne
	  Zephyr-Abhaengigkeit, auf dem PC testbar.

config WALLFREE_NVM
	bool "Wallfree Parameterspeicher (hardwareunabhaengig)"
	help
	  Anhaengendes Log-Format in einer Loescheinheit (SOLL-NVM-01..05)
	  und Leser fuer den Parameterbereich der Originalfirmware
	  (SOLL-NVM-10). Reines C, auf dem PC testbar. Mit
	  WALLFREE_EVSE kommt die Persistenz der Ladelogik dazu.

config WALLFREE_API
	bool "Wallfree HTTP-API ohne Netzwerk (hardwareunabhaengig)"
	depends on WALLFREE_EVSE
	help
	  Digest-Authentifizierung (MD5), minimales JSON und Abbildung der
	  Ladelogik auf die WARP-angelehnte API (Soll-Spezifikation 12.1).
	  Reines C, auf dem PC testbar.
```

## boards/phoenix/ev_cc_ac1/board.yml
```yaml
# SPDX-License-Identifier: Apache-2.0
board:
  name: ev_cc_ac1
  full_name: Phoenix Contact EV-CC-AC1-M3-CBC-RCM-ETH (vorlaeufig)
  socs:
    - name: stm32f207xx
```

## tests/evse/charger/testcase.yaml
```yaml
tests:
  wallfree.evse.charger:
    platform_allow:
      - native_sim/native/64
    integration_platforms:
      - native_sim/native/64
    tags: wallfree evse
```

## tests/evse/meas/testcase.yaml
```yaml
# SPDX-License-Identifier: Apache-2.0
tests:
  wallfree.evse.meas:
    platform_allow:
      - native_sim/native/64
    integration_platforms:
      - native_sim/native/64
    tags: wallfree evse
```
